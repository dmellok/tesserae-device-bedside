/*
 * local.c: the device-drawn UI. See local.h.
 *
 * The "Bedside pages" design (proposal mock-up, third revision):
 *   top bar     date . context, and the four key labels under the keys
 *   status bar  along the bottom of every screen: volume, what is playing,
 *               the alarm, power / night / Wi-Fi. Never covered.
 *   menu        a list panel on the right, over the dashboard
 *   pages       full width between the bars: big value left, a short list
 *               the knob edits on the right, quick actions on keys 1-3
 *   ring        the alarm screen
 *
 * Rendering: each layer is a small draw list of ops in panel coordinates,
 * rebuilt whenever state changes and replayed per row by local_overlay_row().
 * Text is Albert Sans and icons are Phosphor Bold, both as 4-bit bitmaps
 * generated by tools/gen_font.py.
 */
#include "local.h"
#include "draw.h"
#include "bfont.h"
#include "config.h"
#include "net.h"
#include "tesserae.h"
#include "net_rest.h"
#include "birds.h"
#include "ha.h"
#include "live.h"
#include <strings.h>
#include <ctype.h>
#include "inputs.h"
#include "ota.h"
#include "icons.h"
#include "it8951.h"
#include "alarm_sched.h"
#include "audio.h"
#include "power.h"

#include <stdio.h>
#include <string.h>
#include <stdlib.h>
#include <stdarg.h>
#include <math.h>
#include "pico/stdlib.h"

#ifndef FW_VERSION
#define FW_VERSION "0.1.0"
#endif

/* ---- geometry ------------------------------------------------------------- */
#define W            IT8951_W
#define H            IT8951_H
#define TB_H         150                /* top bar */
#define MARGIN       67                 /* 3.6 cqw */
#define BODY_Y       TB_H
#define SB_H         130                /* status bar */
#define SB_Y         (H - SB_H)
#define MENU_W       768
#define MENU_X       ((W - MENU_W - 32) & ~15)
#define MENU_Y       (TB_H + 24)
#define COL2_X       960                /* page: list column */
#define KEY_CELL     180
static const int KEY_CX[4] = { 1204, 1372, 1543, 1711 };

/* Type ramp (Albert Sans Medium, generated by tools/gen_font.py). */
#define F_S     (&ui30)      /* footnotes, meta, chips */
#define F_LBL   (&ui34)      /* key labels, sheet values */
#define F_M     (&ui46)      /* date, titles, menu rows, body */
#define F_L     (&ui72)      /* overlay values */
#define F_XL    (&ui96)      /* big words */
#define F_NUM   (&num180)    /* big values */
#define F_HUGE  (&num270)    /* the alarm screen's time */
#define DEG     "\x7f"
#define DOT     "\x80"
#define F_I     (&icon34)    /* icons beside 34 px text */
#define F_IM    (&icon46)    /* icons beside 46 px text */

/* ---- draw list ------------------------------------------------------------ */
typedef enum { OP_FILL, OP_FRAME, OP_TEXT, OP_CIRCLE, OP_RING, OP_RRECT, OP_LINE, OP_DASH } op_kind_t;
typedef struct {
    uint8_t kind, g, border;
    const bfont_t *font;
    int16_t x, y, w, h;              /* circle: x,y centre, w radius; ring: h = inner colour;
                                        rrect: border = radius; line: to (x+w, y+h), border = thickness;
                                        dash: border = dash length */
    char    text[96];
} op_t;

#define MAX_OPS 180
typedef struct {
    op_t ops[MAX_OPS];
    int  n;
    int  x, y, w, h;                 /* region this layer owns */
    uint8_t bg;
    bool on;
} layer_t;


static void layer_reset(layer_t *l, int x, int y, int w, int h, uint8_t bg)
{
    l->n = 0; l->x = x; l->y = y; l->w = w; l->h = h; l->bg = bg; l->on = true;
}

static op_t *op_new(layer_t *l)
{
    if (l->n >= MAX_OPS) return &l->ops[MAX_OPS - 1];
    op_t *o = &l->ops[l->n++];
    memset(o, 0, sizeof *o);
    return o;
}

static void op_fill(layer_t *l, int x, int y, int w, int h, uint8_t g)
{ op_t *o = op_new(l); o->kind = OP_FILL; o->x = x; o->y = y; o->w = w; o->h = h; o->g = g; }

static void op_frame(layer_t *l, int x, int y, int w, int h, int b, uint8_t g)
{ op_t *o = op_new(l); o->kind = OP_FRAME; o->x = x; o->y = y; o->w = w; o->h = h; o->border = b; o->g = g; }

static void op_text(layer_t *l, int x, int y, const bfont_t *f, uint8_t g, const char *t)
{ op_t *o = op_new(l); o->kind = OP_TEXT; o->x = x; o->y = y; o->font = f; o->g = g;
  o->w = draw_font_w(f, t); o->h = f->line_h; snprintf(o->text, sizeof o->text, "%s", t); }

static void op_text_c(layer_t *l, int cx, int y, const bfont_t *f, uint8_t g, const char *t)
{ op_text(l, cx - draw_font_w(f, t) / 2, y, f, g, t); }

static void op_text_r(layer_t *l, int xr, int y, const bfont_t *f, uint8_t g, const char *t)
{ op_text(l, xr - draw_font_w(f, t), y, f, g, t); }

static void op_rrect(layer_t *l, int x, int y, int w, int h, int r, uint8_t g)
{ op_t *o = op_new(l); o->kind = OP_RRECT; o->x = x; o->y = y; o->w = w; o->h = h; o->border = (uint8_t)r; o->g = g; }
static void op_line(layer_t *l, int x0, int y0, int x1, int y1, int t, uint8_t g)
{ op_t *o = op_new(l); o->kind = OP_LINE; o->x = x0; o->y = y0; o->w = x1 - x0; o->h = y1 - y0; o->border = (uint8_t)t; o->g = g; }
static void op_dash(layer_t *l, int x, int y, int w, int h, int d, uint8_t g)
{ op_t *o = op_new(l); o->kind = OP_DASH; o->x = x; o->y = y; o->w = w; o->h = h; o->border = (uint8_t)d; o->g = g; }
static void op_circle(layer_t *l, int cx, int cy, int r, uint8_t g)
{ op_t *o = op_new(l); o->kind = OP_CIRCLE; o->x = cx; o->y = cy; o->w = r; o->g = g; }

__attribute__((unused)) static void op_ring(layer_t *l, int cx, int cy, int r, int b, uint8_t g, uint8_t inner)
{ op_t *o = op_new(l); o->kind = OP_RING; o->x = cx; o->y = cy; o->w = r; o->border = b; o->g = g; o->h = inner; }


static int isqrt_i(int v) { int r = 0; while ((r + 1) * (r + 1) <= v) r++; return r; }

static void layer_row(const layer_t *l, int y, uint8_t *line, uint8_t row[IT8951_ROW_BYTES])
{
    if (!l->on || y < l->y || y >= l->y + l->h) return;
    /* Only the columns being streamed: a 59 px gutter beside the menu used to
     * cost a full-width render of every row. Ops entirely outside are skipped. */
    int wx0, wx1; it8951_stream_window(&wx0, &wx1);
    if (wx0 < l->x) wx0 = l->x;
    if (wx1 > l->x + l->w) wx1 = l->x + l->w;
    if (wx1 <= wx0) return;
    memset(line + wx0, l->bg, (size_t)(wx1 - wx0));
    for (int i = 0; i < l->n; i++) {
        const op_t *o = &l->ops[i];
        if (o->kind == OP_FILL || o->kind == OP_FRAME || o->kind == OP_TEXT || o->kind == OP_RRECT || o->kind == OP_DASH) {
            if (o->x >= wx1 || o->x + o->w <= wx0) continue;
        }
        switch (o->kind) {
        case OP_FILL:
            if (y >= o->y && y < o->y + o->h) memset(line + o->x, o->g, (size_t)o->w);
            break;
        case OP_FRAME:
            if (y < o->y || y >= o->y + o->h) break;
            if (y < o->y + o->border || y >= o->y + o->h - o->border) memset(line + o->x, o->g, (size_t)o->w);
            else { memset(line + o->x, o->g, (size_t)o->border); memset(line + o->x + o->w - o->border, o->g, (size_t)o->border); }
            break;
        case OP_TEXT:
            if (y >= o->y && y < o->y + o->h) draw_font_row(o->font, line, W, o->x, o->text, y - o->y, o->g);
            break;
        case OP_CIRCLE: {
            int dy = y - o->y;
            if (dy < -o->w || dy > o->w) break;
            int half = isqrt_i(o->w * o->w - dy * dy);
            int x0 = o->x - half; if (x0 < 0) x0 = 0;
            int x1 = o->x + half; if (x1 >= W) x1 = W - 1;
            memset(line + x0, o->g, (size_t)(x1 - x0 + 1));
            break; }
        case OP_RRECT: {
            if (y < o->y || y >= o->y + o->h) break;
            int r = o->border, d = y - o->y, d2 = o->y + o->h - 1 - y;
            if (d2 < d) d = d2;
            int in = 0;
            if (d < r) { int k = r - d; in = r - isqrt_i(r * r - k * k); }
            if (o->w - 2 * in > 0) memset(line + o->x + in, o->g, (size_t)(o->w - 2 * in));
            break; }
        case OP_LINE: {
            int t = o->border, x0 = o->x, y0 = o->y, x1 = o->x + o->w, y1 = o->y + o->h;
            int ylo = (y0 < y1 ? y0 : y1) - t / 2, yhi = (y0 > y1 ? y0 : y1) + t / 2;
            if (y < ylo || y > yhi) break;
            int xl = x0 < x1 ? x0 : x1, xr = x0 > x1 ? x0 : x1, a, b;
            if (y1 == y0) { a = xl; b = xr; }
            else {
                a = x0 + (y - t / 2 - y0) * (x1 - x0) / (y1 - y0);
                b = x0 + (y + t / 2 - y0) * (x1 - x0) / (y1 - y0);
                if (a > b) { int s = a; a = b; b = s; }
                if (a < xl) a = xl;
                if (b > xr) b = xr;
                if (a > b) break;
            }
            a -= t / 2; b += t / 2;
            if (a < 0) a = 0;
            if (b >= W) b = W - 1;
            memset(line + a, o->g, (size_t)(b - a + 1));
            break; }
        case OP_DASH:
            if (y < o->y || y >= o->y + o->h) break;
            for (int xx = o->x; xx < o->x + o->w; xx += 2 * o->border) {
                int e = xx + o->border; if (e > o->x + o->w) e = o->x + o->w;
                memset(line + xx, o->g, (size_t)(e - xx));
            }
            break;
        case OP_RING: {
            int dy = y - o->y;
            if (dy < -o->w || dy > o->w) break;
            int half = isqrt_i(o->w * o->w - dy * dy);
            memset(line + o->x - half, o->g, (size_t)(2 * half + 1));
            int ri = o->w - o->border;
            if (dy >= -ri && dy <= ri) {
                int hi = isqrt_i(ri * ri - dy * dy);
                memset(line + o->x - hi, (uint8_t)o->h, (size_t)(2 * hi + 1));
            }
            break; }
        }
    }
    draw_pack(row, wx0, line + wx0, wx1 - wx0);
}

/* ---- state ---------------------------------------------------------------- */
static local_state_t S = {
    .alarm_h = 6, .alarm_m = 30, .alarm_on = true, .days = {1,1,1,1,1,0,0}, .offset_min = 15,
    .rain_on = true, .rain_lvl = 3, .rain_kind = 0, .sleep_min = 0,
    .lights_on = false, .bright = 40, .light_mode = 0,
    .ac_mode = 3, .sp_x2 = 44, .room_x10 = 234, .fan = 0,
    .vol = 6, .night = false, .on_battery = false, .batt_pct = 92,
    .dash_page = 0, .dash_count = 3,
    .patter = 60, .wash = 55, .tone = 50, .wind = 20, .surface = 0, .thunder = 0, .thunder_near = 35,
    .birds = BIRDS_ALL, .bird_vol = 6,
    .key_col = 0, .menu_col = 3, .night_col = 4, .knob_light = true, .auto_night = 0, .clock12 = false, .snooze_min = 9,
    .speaker = true, .power_mon = false, .rec = "", .wf_temp = 0, .turn_hints = true, .quick_menus = true, .settle_full = false,
    .night_keys = 0, .overlay = 0, .show = 0x07, .at_night = 1, .tz = 0, .auto_time = true, .refresh_mode = 1,
};
static char s_date[40];
static uint32_t s_preview_start_ms, s_preview_len_ms;   /* dawn-chorus preview (local_alarm_tick) */
static uint32_t s_settle_due;                            /* quick menus: when the full-quality pass is due (0 = none) */
static bool s_trace_marks = false;                       /* diagnostics: log every dirty rect */
static bool     s_settle_queued;                         /* its rects are in the dirty queue, not yet painted */
static void chorus_preview(int seconds);

static layer_t L_top, L_body, L_sb, L_ring;
static void overlay_apply(void);
static void viewport(int *x, int *y, int *w, int *h);
static int  ov_kind(void);
static void toast(const char *icon, const char *txt, const char *val);
static void build_overlay(layer_t *l);
static void build_toast(layer_t *l);
static void fmt_hm(char *b, size_t n, int mins);
static void manual_start(void);
static bool local_ymd(int *y, int *m, int *d, int *wd);
static int64_t utc_now(void);
static int32_t tz_offset_at(int64_t utc);
static bool clock_now(int *wday, int *sec, int64_t *minute);
static bool next_alarm(int *idx, int32_t *delta_s);
static bool local_live_tick_inner(void);
static uint32_t s_toast_until;
static int  s_man_days;
static int64_t s_man_base;
static const char *const MONTHS[12];
#define TOAST_W 1040
#define TOAST_H 320
#define TOAST_X (((W - TOAST_W) / 2) & ~15)
#define TOAST_Y ((H - TOAST_H) / 2)

static inline uint32_t now_ms(void) { return to_ms_since_boot(get_absolute_time()); }
local_state_t *local_state(void) { return &S; }

static const char *const SCREEN_NAMES[SCR_COUNT] = { "home", "menu", "rain", "lights", "ac", "alarm", "settings" };
const char *local_screen_name(screen_t s) { return (s >= 0 && s < SCR_COUNT) ? SCREEN_NAMES[s] : "?"; }
static const char *const AC_MODES[5] = { "Off", "Heat", "Fan", "Cool", "Dry" };
static const char *const FANS[4]     = { "Auto", "Low", "Mid", "High" };
static const char *const KINDS[5]    = { "Rain", "Ocean", "Noise", "Wind", "Recording" };
static const char *const DASHES[3]   = { "Live", "Bedside", "Tomorrow" };   /* 0: drawn on the device (build_live) */
/* Key light palette. */
typedef struct { const char *name; uint8_t rgb[3]; } pal_t;
static const pal_t PAL[9] = {
    { "Warm white", { 255, 200, 150 } }, { "White", { 255, 255, 255 } }, { "Amber", { 255, 140, 20 } },
    { "Orange", { 255, 110, 10 } },      { "Red", { 255, 0, 0 } },        { "Green", { 40, 255, 60 } },
    { "Blue", { 40, 90, 255 } },          { "Purple", { 170, 40, 255 } },  { "Pink", { 255, 60, 150 } },
};
#define N_PAL 9
static const char *PAL_NAMES[N_PAL] = { "Warm white", "White", "Amber", "Orange", "Red", "Green", "Blue", "Purple", "Pink" };
int local_palette_count(void) { return N_PAL; }
const char *local_palette_name(int i) { return (i >= 0 && i < N_PAL) ? PAL[i].name : ""; }
static const char *const AUTONIGHT[4] = { "Off", "21:00 to 07:00", "22:00 to 07:00", "23:00 to 07:00" };
static const char *const CLOCKF[2]    = { "24-hour", "12-hour" };
static const char *const SNOOZES[4]   = { "5 min", "9 min", "10 min", "15 min" };
/* Waveform temperature: the controller's own sensor is on the HAT, not the glass */
#define N_WFTEMP 9
static const char *const WFTEMPS[N_WFTEMP] = { "Default (20)", "14 C", "16 C", "18 C", "22 C", "24 C", "26 C", "28 C", "30 C" };
static const int         WFTEMP_V[N_WFTEMP] = { 0, 14, 16, 18, 22, 24, 26, 28, 30 };
static const int SNOOZE_V[4] = { 5, 9, 10, 15 };
static const char *const RESETS[2]    = { "Keep everything", "Reset everything" };
static local_req_t s_req;
local_req_t local_take_request(void) { local_req_t r = s_req; s_req = LREQ_NONE; return r; }
static void apply_colours(void)
{
    /* At night the keys keep their day colour at a low glow, or go dark. */
    const uint8_t *k = PAL[S.key_col % N_PAL].rgb;
    uint8_t night[3] = { 0, 0, 0 };
    if (S.night_keys == 0) for (int i = 0; i < 3; i++) night[i] = (uint8_t)(k[i] * 12 / 100);
    inputs_set_colours(k, PAL[S.menu_col % N_PAL].rgb, night, S.knob_light);
}
static const char *const OVERLAYS[4]  = { "Strip", "Cards left", "Cards bottom", "Off" };
static const char *const ATNIGHT[2]   = { "Same", "Clock only" };
static const char *const NIGHTKEYS[2] = { "Dim", "Off" };
static const char *const REFRESHES[3] = { "Fast", "Clean", "Full" };
int local_refresh_mode(void) { return S.refresh_mode; }
/* What keys 1-3 can do, pressed or held (ids as in the action table). */
#define N_KEYACT 15
static const char *const KEYACT_ID[N_KEYACT] = { "rain.toggle", "lights.toggle", "ac.toggle", "dash.prev", "dash.next", "night", "light.night",
    "alarm.toggle", "open.sound", "open.lights", "open.ac", "open.alarm", "menu", "refresh", "none" };
static const char *const KEYACT_NAME[N_KEYACT] = { "Rain on/off", "Lights on/off", "AC on/off", "Previous dashboard", "Next dashboard", "Night mode", "Night light",
    "Alarm on/off", "Open Rain", "Open Lights", "Open AC", "Open Alarms", "Open menu", "Refresh dashboard", "Nothing" };
#define N_KNOBACT 5
static const char *const KNOBACT_ID[N_KNOBACT]   = { "back", "none", "night", "rain.toggle", "dash.next" };
static const char *const KNOBACT_NAME[N_KNOBACT] = { "Back", "Nothing", "Night mode", "Rain on/off", "Next dashboard" };
/* Time zones: standard offset and daylight-saving rule (0 none, 1 south-east
 * Australia: first Sunday in October to first Sunday in April, 2 New Zealand:
 * last Sunday in September to first Sunday in April). */
typedef struct { const char *name; int32_t std_s; uint8_t dst; } tzone_t;
#define N_TZ 9
static const tzone_t TZONES[N_TZ] = {
    { "Automatic", 0, 0 }, { "Melbourne, Sydney", 36000, 1 }, { "Hobart", 36000, 1 }, { "Brisbane", 36000, 0 },
    { "Adelaide", 34200, 1 }, { "Darwin", 34200, 0 }, { "Perth", 28800, 0 }, { "Auckland", 43200, 2 }, { "UTC", 0, 0 },
};
static const char *TZ_NAMES[N_TZ] = { "Automatic", "Melbourne, Sydney", "Hobart", "Brisbane", "Adelaide", "Darwin", "Perth", "Auckland", "UTC" };
static const char *const SURFACES[4] = { "Open ground", "Leaves", "Tin roof", "Window" };
static const char *const THUNDERS[3] = { "Off", "Distant", "Storm" };



static void rebuild(void);
static void publish(const char *topic, const char *fmt, ...);
/* Show dashboard k: 0 = the live page drawn here; 1, 2 = the server's rotation
 * (moving between those two steps the rotation; to and from Live only swaps
 * what main.c paints underneath). */
/* The dashboard picker: Live (drawn here), then the server's list. */
static int s_dash_sel;                      /* 0 Live, 1.. the list */
static const char *s_dash_opt[1 + TESS_PICK_MAX];
static const char *const *dash_opts(void)
{
    s_dash_opt[0] = "Live";
    for (int i = 0; i < tesserae_pick_count(); i++) s_dash_opt[1 + i] = tesserae_pick_title(i);
    return s_dash_opt;
}
static void toast_loading(const char *title);
static void dash_pick(int k)
{
    if (k < 1 || k > tesserae_pick_count()) return;
    s_dash_sel = k;
    if (S.dash_page == 0) { S.dash_page = 1; publish("config/dashboard", "%s", "bedside"); }
    tesserae_pick(k - 1);
    toast_loading(tesserae_pick_title(k - 1));
}

static void dash_go(int k)
{
    if (k < 0 || k > 2 || k == S.dash_page) return;
    if (S.dash_page > 0 && k > 0) tesserae_button(k > S.dash_page ? "right" : "left");
    S.dash_page = k;
    publish("config/dashboard", "%s", k == 0 ? "live" : k == 1 ? "bedside" : "tomorrow");
}
static void sound_load(void);
static void settings_load(void);
static void ext_load(void);

/* ---- dirty regions ----------------------------------------------------------
 * A list of small rectangles, each painted on its own, so changing one value
 * never resends a whole strip of the screen. A rectangle that overlaps one
 * already queued is merged into it. UI changes use GL16 (16 greys, no flash);
 * main.c runs a full GC16 clean-up after many of them. */
#define MAX_DIRTY 8
static local_dirty_t s_dq[MAX_DIRTY];
static int s_dn;
static uint32_t s_epoch;
uint32_t local_epoch(void) { return s_epoch; }

static void mark(int x, int y, int w, int h, uint8_t mode)
{
    if (w <= 0 || h <= 0) return;
    if (s_trace_marks) printf("local: mark [%d,%d %dx%d] mode %u\n", x, y, w, h, mode);
    for (int i = 0; i < s_dn; i++) {
        local_dirty_t *d = &s_dq[i];
        const int g = 32;   /* near enough: one refresh, and nothing much in between */
        if (x < d->x + d->w + g && d->x < x + w + g && y < d->y + d->h + g && d->y < y + h + g) {
            int x1 = (x + w > d->x + d->w) ? x + w : d->x + d->w, y1 = (y + h > d->y + d->h) ? y + h : d->y + d->h;
            if (x < d->x) d->x = x;
            if (y < d->y) d->y = y;
            d->w = x1 - d->x; d->h = y1 - d->y;
            if (mode == IT8951_MODE_GC16 || (mode == IT8951_MODE_GL16 && d->mode != IT8951_MODE_GC16)) d->mode = mode;
            return;
        }
    }
    if (s_dn == MAX_DIRTY) { s_dn = 0; mark(0, 0, W, H, IT8951_MODE_GL16); return; }
    s_dq[s_dn++] = (local_dirty_t){ x, y, w, h, mode, false };
}
/* A rect that must stay its own job area (not merged with a neighbour): the
 * turn-count gutter beside two changed rows streams far less than the list. */
static void mark_apart(int x, int y, int w, int h, uint8_t mode)
{
    if (w <= 0 || h <= 0) return;
    if (s_dn == MAX_DIRTY) { mark(x, y, w, h, mode); return; }
    s_dq[s_dn++] = (local_dirty_t){ x, y, w, h, mode, false };
}
static void mark_full(uint8_t mode) { s_dn = 0; mark(0, 0, W, H, mode); }
void local_set_dirty_full(void) { mark_full(IT8951_MODE_GC16); }
bool local_take_dirty(local_dirty_t *out)
{
    if (!s_dn) return false;
    s_settle_queued = false;
    *out = s_dq[0];
    out->full = (out->w >= W && out->h >= H);
    memmove(&s_dq[0], &s_dq[1], sizeof(local_dirty_t) * (size_t)(--s_dn));
    return true;
}

/* Regions the layouts below use. */
#define R_LABELS()  mark(1080, 0, W - 1080, TB_H, IT8951_MODE_GL16)       /* key labels */
#define R_TOPBAR()  mark(0, 0, W, TB_H, IT8951_MODE_GL16)
static bool ov_active(void);
static void mark_ov(void);
static layer_t s_prev_sb;
static void layer_copy(layer_t *d, const layer_t *s);
#define R_VOL()     do { if (ov_active()) mark_ov(); else mark_changed(&s_prev_sb, &L_sb, 0, SB_Y + 5, 700, SB_H - 5, IT8951_MODE_GL16); } while (0)   /* volume and sound */
#define R_SBMID()   do { if (ov_active()) mark_ov(); else mark_changed(&s_prev_sb, &L_sb, 0, SB_Y + 5, W, SB_H - 5, IT8951_MODE_GL16); } while (0)   /* the bar */

/* ---- MQTT placeholders (Phase 3) -------------------------------------------- */
static void publish(const char *topic, const char *fmt, ...)
{
    char b[64]; va_list ap; va_start(ap, fmt); vsnprintf(b, sizeof b, fmt, ap); va_end(ap);
    printf("mqtt: bedside/%s %s\n", topic, b);
    if (!strcmp(topic, "event")) ha_event(b);       /* HA's event entity (ha.c) */
}
__attribute__((unused)) static const char *days_txt(void)
{
    int n = 0, wk = 1; for (int i = 0; i < 7; i++) { n += S.days[i]; if (i < 5 && !S.days[i]) wk = 0; if (i >= 5 && S.days[i]) wk = 0; }
    if (n == 7) return "Every day";
    if (wk) return "Weekdays";
    if (n == 2 && S.days[5] && S.days[6]) return "Weekends";
    return n ? "Custom" : "No days";
}
static void alarm_txt(char *b, size_t n) { snprintf(b, n, "%02d:%02d", S.alarm_h, S.alarm_m); }
static int clampi(int v, int lo, int hi) { return v < lo ? lo : v > hi ? hi : v; }
__attribute__((unused)) static int cyc(int v, int n, int d) { return ((v + d) % n + n) % n; }

/* ---- actions (key bindings) -------------------------------------------------- */
typedef struct { const char *id, *label; } action_t;
static const action_t ACTIONS[] = {
    { "none",          "Nothing" },
    { "rain.toggle",   "Rain on/off" },
    { "lights.toggle", "Lights on/off" },
    { "ac.toggle",     "AC on/off" },
    { "alarm.toggle",  "Alarm on/off" },
    { "light.night",   "Night light" },
    { "dash.next",     "Next dashboard" },
    { "dash.prev",     "Previous dashboard" },
    { "open.sound",    "Open Sound" },
    { "open.lights",   "Open Lights" },
    { "open.ac",       "Open AC" },
    { "open.alarm",    "Open Alarm" },
    { "open.weather",  "Open Weather" },
    { "open.status",   "Open Status" },
    { "open.keys",     "Open Keys" },
    { "menu",          "Open menu" },
    { "menu_select",   "Knob press" },
    { "back",          "Back" },
    { "night",         "Night mode" },
    { "vol.up",        "Volume up" },
    { "vol.down",      "Volume down" },
    { "refresh",       "Refresh dashboard" },
    { "fetch",         "Fetch frame now" },
    { "dashboard",     "Show dashboard" },
    { "card",          "Show test card" },
    { "clear",         "Clear screen (INIT)" },
    { "sleep",         "Sleep the panel" },
    { "backlight_up",  "Key lights brighter" },
    { "backlight_down","Key lights dimmer" },
    { "repair",        "Re-pair with Tesserae" },
    { "button:",       "Server button (name)..." },
};
#define ACTION_COUNT ((int)(sizeof ACTIONS / sizeof ACTIONS[0]))
int local_action_count(void) { return ACTION_COUNT; }
const char *local_action_id(int i) { return (i >= 0 && i < ACTION_COUNT) ? ACTIONS[i].id : ""; }
const char *local_action_name(int i) { return (i >= 0 && i < ACTION_COUNT) ? ACTIONS[i].label : ""; }
__attribute__((unused)) static const char *action_name(const char *id)
{
    for (int a = 0; a < ACTION_COUNT; a++) if (!strcmp(id, ACTIONS[a].id)) return ACTIONS[a].label;
    return id;
}

/* The icon the top bar shows under a key for its press action. */
static const char *action_icon(const char *spec)
{
    if (!spec || !spec[0] || !strcmp(spec, "none")) return NULL;
    if (!strcmp(spec, "rain.toggle") || !strcmp(spec, "open.sound")) return ICON_CLOUD_RAIN;
    if (!strcmp(spec, "lights.toggle") || !strcmp(spec, "light.night") || !strcmp(spec, "open.lights")) return ICON_LIGHTBULB;
    if (!strcmp(spec, "ac.toggle") || !strcmp(spec, "open.ac")) return ICON_SNOWFLAKE;
    if (!strcmp(spec, "alarm.toggle") || !strcmp(spec, "open.alarm")) return ICON_ALARM;
    if (!strcmp(spec, "dash.prev")) return ICON_SKIP_BACK;
    if (!strcmp(spec, "dash.next")) return ICON_SKIP_FORWARD;
    if (!strcmp(spec, "night")) return ICON_MOON;
    if (!strcmp(spec, "menu")) return ICON_LIST;
    if (!strcmp(spec, "refresh") || !strcmp(spec, "fetch")) return ICON_HOUSE;
    return ICON_KEYBOARD;
}

const char *local_label_for_action(const char *spec)
{
    static char b[16];
    if (!spec || !spec[0] || !strcmp(spec, "none")) return "";
    /* Fixed names: the status bar shows the state, so a toggle repaints one area. */
    if (!strcmp(spec, "rain.toggle"))   return "Rain";
    if (!strcmp(spec, "lights.toggle")) return "Lights";
    if (!strcmp(spec, "ac.toggle"))     return "AC";
    if (!strcmp(spec, "alarm.toggle"))  return "Alarm";
    if (!strcmp(spec, "light.night"))   return "Night light";
    if (!strcmp(spec, "dash.next"))     return "Next page";
    if (!strcmp(spec, "dash.prev"))     return "Prev page";
    if (!strcmp(spec, "open.ac"))       return "AC";
    if (!strncmp(spec, "open.", 5))     { snprintf(b, sizeof b, "%c%s", spec[5] - 32, spec + 6); return b; }
    if (!strcmp(spec, "menu"))          return "Menu";
    if (!strcmp(spec, "night"))         return "Night";
    if (!strcmp(spec, "vol.up"))        return "Louder";
    if (!strcmp(spec, "vol.down"))      return "Quieter";
    if (!strcmp(spec, "refresh") || !strcmp(spec, "fetch")) return "Refresh";
    if (!strncmp(spec, "button:", 7))   { snprintf(b, sizeof b, "%s", spec + 7); if (b[0] >= 'a' && b[0] <= 'z') b[0] -= 32; return b; }
    return "";
}

/* ---- the click-wheel UI ---------------------------------------------------------
 * After the iPod. Every control means one thing everywhere:
 *   knob turn      scroll a list one row a detent, move a value (faster turns take bigger steps);
 *                  on the dashboard: volume
 *   knob press     choose (the wheel's centre button)
 *   knob hold      back, the same as MENU
 *   key 1  <<      previous dashboard        key 3  >>   next dashboard
 *   key 2  >||     rain play / pause; hold: bedroom lights on / off
 *   key 4  MENU    (orange) back one level; hold: straight home
 * Every list ends with a Back row. When the alarm rings the centre stops it
 * and anything else snoozes.                                                 */

typedef enum { M_HOME, M_LIST, M_VALUE, M_CHOICE } mode_t_;
static mode_t_ s_mode = M_HOME;

typedef enum { N_ROOT, N_RAIN, N_LIGHTS, N_AC, N_ALARMS, N_ALARM, N_DAYS, N_SETTINGS, N_CHORUS,
               N_HOMESCR, N_NIGHTG, N_KEYS, N_KEY, N_TIMEG, N_DEVICE, N_SOFTWARE, N_COUNT } node_t;
typedef enum { K_TOGGLE, K_VALUE, K_CHOICE, K_SUB, K_INFO, K_ACTION, K_BACK } rk_t;
typedef enum {
    T_RAIN, V_RAIN_LVL, C_RAIN_KIND, C_SLEEP, C_SURFACE, C_THUNDER,
    T_LIGHTS, V_BRIGHT, C_COLOUR,
    T_AC, V_SETPOINT, C_AC_MODE, C_FAN,
    S_ALARM_ITEM, A_ADD_ALARM, S_CHORUS,            /* the alarms list */
    T_BIRD, V_BIRD_VOL, A_PREVIEW,                  /* the dawn chorus */
    C_KEYCOL, C_MENUCOL, C_NIGHTCOL, T_KNOB, C_AUTONIGHT, C_CLOCK, C_SNOOZE, A_REFRESH, A_RESTART, C_RESET,
    T_ALARM_ON, V_ALARM_TIME, S_DAYS, C_EARLY, A_DELETE_ALARM,
    T_DAY,
    C_DASH, T_NIGHT, V_KEYS, I_STATUS,
    S_RAIN, S_LIGHTS, S_AC, S_ALARMS, S_SETTINGS, R_BACK,
    /* Mk II settings groups */
    S_HOMESCR, S_NIGHTG, S_KEYS, S_KEY, S_TIMEG, S_DEVICE,
    C_OVERLAY, T_SHOW, C_ATNIGHT, I_VIEWPORT, C_NIGHTKEYS,
    C_KEY_PRESS, C_KEY_HOLD, C_KNOB_HOLD, I_MENUKEY,
    T_AUTOTIME, C_TZ, V_TIME, V_DATE, C_REFRESHMODE, C_WFTEMP, A_WIFISETUP,
    S_SOFTWARE, I_FWVER, A_OTACHECK, T_AUTOUPD, A_RELEASE,
    T_SPEAKER, T_POWERMON, T_TURNHINTS, T_QUICKMENU, T_SETTLEFULL,
} item_t;

typedef struct { item_t id; rk_t kind; const char *label, *icon; int arg; } row_def_t;

/* ---- alarms ---- */
#define MAX_ALARMS 4
static alarm_t s_alarms[MAX_ALARMS] = { { 6, 30, true, {1,1,1,1,1,0,0}, 15 } };
static int s_nalarms = 1, s_ai;       /* count; the alarm being edited */
static int s_ki;                      /* the key being set (0..2) */
static int s_rel_armed = -1;           /* the release row pressed once (Software) */
static const char *const DAY_NAMES[7] = { "Monday", "Tuesday", "Wednesday", "Thursday", "Friday", "Saturday", "Sunday" };

static void alarm_days_txt(const alarm_t *a, char *b, size_t n)
{
    int c = 0; for (int i = 0; i < 7; i++) c += a->days[i];
    bool wk = a->days[0] && a->days[1] && a->days[2] && a->days[3] && a->days[4];
    if (c == 7) { snprintf(b, n, "Every day"); return; }
    if (c == 5 && wk) { snprintf(b, n, "Weekdays"); return; }
    if (c == 2 && a->days[5] && a->days[6]) { snprintf(b, n, "Weekends"); return; }
    if (c == 0) { snprintf(b, n, "Once"); return; }
    size_t k = 0; b[0] = 0;
    for (int i = 0; i < 7 && k + 4 < n; i++) if (a->days[i]) k += (size_t)snprintf(b + k, n - k, "%s%.2s", k ? " " : "", DAY_NAMES[i]);
}
/* The summary the status bar, the alarm screen and the web page show: the
 * first alarm that is on (or the first alarm). */
static void sync_alarm_summary(void)
{
    int k = 0;
    for (int i = 0; i < s_nalarms; i++) if (s_alarms[i].on) { k = i; break; }
    if (!s_nalarms) { S.alarm_on = false; return; }
    S.alarm_h = s_alarms[k].h; S.alarm_m = s_alarms[k].m; S.alarm_on = s_alarms[k].on;
    memcpy(S.days, s_alarms[k].days, 7); S.offset_min = s_alarms[k].early;
}
/* Alarms persist in the flash config. */
static void alarms_load(void)
{
    const config_t *c = config_get();
    s_nalarms = c->n_alarms > MAX_ALARMS ? MAX_ALARMS : c->n_alarms;
    for (int i = 0; i < s_nalarms; i++) {
        s_alarms[i].h = c->alarms[i].h % 24; s_alarms[i].m = c->alarms[i].m % 60; s_alarms[i].on = c->alarms[i].on;
        s_alarms[i].early = c->alarms[i].early;
        for (int d = 0; d < 7; d++) s_alarms[i].days[d] = (c->alarms[i].days >> d) & 1;
    }
}
static void alarms_save(void)
{
    config_t *c = config_mut();
    c->n_alarms = (uint8_t)s_nalarms;
    for (int i = 0; i < s_nalarms; i++) {
        uint8_t m = 0; for (int d = 0; d < 7; d++) if (s_alarms[i].days[d]) m |= (uint8_t)(1u << d);
        c->alarms[i].h = (uint8_t)s_alarms[i].h; c->alarms[i].m = (uint8_t)s_alarms[i].m; c->alarms[i].on = s_alarms[i].on;
        c->alarms[i].days = m; c->alarms[i].early = (uint8_t)s_alarms[i].early;
    }
    config_save();
}
static void publish_alarm(int i)
{
    alarms_save();
    char d[40]; alarm_days_txt(&s_alarms[i], d, sizeof d);
    publish("set/alarm", "%d %s %02d:%02d %s early %d", i + 1, s_alarms[i].on ? "on" : "off", s_alarms[i].h, s_alarms[i].m, d, s_alarms[i].early);
}

/* ---- the menu tree ---- */
static row_def_t s_rows[16];
static char s_labels[16][24];
static int node_rows(node_t nd, row_def_t *r)
{
    int n = 0;
    switch (nd) {
    case N_ROOT:
        r[n++] = (row_def_t){ S_RAIN, K_SUB, "Sound", ICON_CLOUD_RAIN, 0 };
        r[n++] = (row_def_t){ S_LIGHTS, K_SUB, "Lights", ICON_LIGHTBULB, 0 };
        r[n++] = (row_def_t){ S_AC, K_SUB, "A/C", ICON_SNOWFLAKE, 0 };
        r[n++] = (row_def_t){ S_ALARMS, K_SUB, "Alarms", ICON_ALARM, 0 };
        r[n++] = (row_def_t){ C_DASH, K_CHOICE, "Dashboard", ICON_HOUSE, 0 };
        r[n++] = (row_def_t){ S_SETTINGS, K_SUB, "Settings", ICON_GEAR, 0 };
        break;      /* Back (appended below) goes home */
    case N_RAIN:
        r[n++] = (row_def_t){ T_RAIN, K_TOGGLE, "Playing", ICON_PLAY, 0 };
        r[n++] = (row_def_t){ V_RAIN_LVL, K_VALUE, "Intensity", ICON_CLOUD_RAIN, 0 };
        r[n++] = (row_def_t){ C_RAIN_KIND, K_CHOICE, "Sound", ICON_SPEAKER_HIGH, 0 };
        if (S.rain_kind == 0) r[n++] = (row_def_t){ C_SURFACE, K_CHOICE, "Falling on", ICON_CLOUD_RAIN, 0 };          /* rain only */
        if (S.rain_kind == 0 || S.rain_kind == 4) r[n++] = (row_def_t){ C_THUNDER, K_CHOICE, "Thunder", ICON_CLOUD_LIGHTNING, 0 };   /* over rain or a recording */
        r[n++] = (row_def_t){ C_SLEEP, K_CHOICE, "Sleep timer", ICON_MOON, 0 };
        break;
    case N_LIGHTS:
        r[n++] = (row_def_t){ T_LIGHTS, K_TOGGLE, "Bedroom lights", ICON_LIGHTBULB, 0 };
        r[n++] = (row_def_t){ V_BRIGHT, K_VALUE, "Brightness", ICON_SUN, 0 };
        r[n++] = (row_def_t){ C_COLOUR, K_CHOICE, "Colour", ICON_LIGHTBULB, 0 };
        break;
    case N_AC:
        r[n++] = (row_def_t){ T_AC, K_TOGGLE, "A/C", ICON_SNOWFLAKE, 0 };
        r[n++] = (row_def_t){ V_SETPOINT, K_VALUE, "Temperature", ICON_THERMOMETER, 0 };
        r[n++] = (row_def_t){ C_AC_MODE, K_CHOICE, "Mode", ICON_SNOWFLAKE, 0 };
        r[n++] = (row_def_t){ C_FAN, K_CHOICE, "Fan", ICON_SNOWFLAKE, 0 };
        break;
    case N_ALARMS:
        for (int i = 0; i < s_nalarms; i++) {
            snprintf(s_labels[i], sizeof s_labels[i], "%02d:%02d", s_alarms[i].h, s_alarms[i].m);
            r[n++] = (row_def_t){ S_ALARM_ITEM, K_SUB, s_labels[i], ICON_ALARM, i };
        }
        if (s_nalarms < MAX_ALARMS) r[n++] = (row_def_t){ A_ADD_ALARM, K_ACTION, "Add alarm", ICON_BELL_RINGING, 0 };
        r[n++] = (row_def_t){ S_CHORUS, K_SUB, "Dawn chorus", ICON_BIRD, 0 };
        break;
    case N_ALARM:
        r[n++] = (row_def_t){ T_ALARM_ON, K_TOGGLE, "Alarm", ICON_ALARM, s_ai };
        r[n++] = (row_def_t){ V_ALARM_TIME, K_VALUE, "Time", ICON_ALARM, s_ai };
        r[n++] = (row_def_t){ S_DAYS, K_SUB, "Days", ICON_CALENDAR_BLANK, s_ai };
        r[n++] = (row_def_t){ C_EARLY, K_CHOICE, "Wake up early", ICON_SUN, s_ai };
        r[n++] = (row_def_t){ A_DELETE_ALARM, K_ACTION, "Delete alarm", ICON_BELL_RINGING, s_ai };
        break;
    case N_DAYS:
        for (int i = 0; i < 7; i++) r[n++] = (row_def_t){ T_DAY, K_TOGGLE, DAY_NAMES[i], NULL, i };
        break;
    case N_CHORUS:
        for (int i = 0; i < BIRD_COUNT; i++) r[n++] = (row_def_t){ T_BIRD, K_TOGGLE, bird_name(i), ICON_BIRD, i };
        r[n++] = (row_def_t){ V_BIRD_VOL, K_VALUE, "Alarm volume", ICON_SPEAKER_HIGH, 0 };
        r[n++] = (row_def_t){ A_PREVIEW, K_ACTION, "Preview", ICON_PLAY, 0 };
        break;
    case N_SETTINGS:
        r[n++] = (row_def_t){ S_HOMESCR, K_SUB, "Home screen", ICON_HOUSE, 0 };
        r[n++] = (row_def_t){ S_NIGHTG, K_SUB, "Night", ICON_MOON, 0 };
        r[n++] = (row_def_t){ S_KEYS, K_SUB, "Keys and knob", ICON_KEYBOARD, 0 };
        r[n++] = (row_def_t){ S_TIMEG, K_SUB, "Time and clock", ICON_ALARM, 0 };
        r[n++] = (row_def_t){ S_DEVICE, K_SUB, "Device", ICON_GEAR, 0 };
        break;
    case N_HOMESCR: {
        static const char *const SHOW_L[5] = { "Show clock", "Show alarm", "Show sound", "Show room", "Show connection" };
        static const char *const SHOW_I[5] = { ICON_ALARM, ICON_BELL_RINGING, ICON_CLOUD_RAIN, ICON_SNOWFLAKE, ICON_WIFI_HIGH };
        r[n++] = (row_def_t){ C_OVERLAY, K_CHOICE, "Overlay", ICON_HOUSE, 0 };
        for (int i = 0; i < 5; i++) r[n++] = (row_def_t){ T_SHOW, K_TOGGLE, SHOW_L[i], SHOW_I[i], i };
        r[n++] = (row_def_t){ C_ATNIGHT, K_CHOICE, "At night", ICON_MOON, 0 };
        r[n++] = (row_def_t){ I_VIEWPORT, K_INFO, "Tesserae gets", ICON_WIFI_HIGH, 0 };
        break; }
    case N_NIGHTG:
        r[n++] = (row_def_t){ T_NIGHT, K_TOGGLE, "Night mode", ICON_MOON, 0 };
        r[n++] = (row_def_t){ C_AUTONIGHT, K_CHOICE, "Auto night", ICON_MOON, 0 };
        r[n++] = (row_def_t){ C_NIGHTKEYS, K_CHOICE, "Keys at night", ICON_KEYBOARD, 0 };
        break;
    case N_KEYS: {
        static const char *const KEY_L[3] = { "Key 1", "Key 2", "Key 3" };
        for (int i = 0; i < 3; i++) r[n++] = (row_def_t){ S_KEY, K_SUB, KEY_L[i], ICON_KEYBOARD, i };
        r[n++] = (row_def_t){ C_KNOB_HOLD, K_CHOICE, "Knob hold", ICON_ARROW_U_UP_LEFT, 0 };
        r[n++] = (row_def_t){ I_MENUKEY, K_INFO, "MENU key", ICON_KEYBOARD, 0 };
        r[n++] = (row_def_t){ T_TURNHINTS, K_TOGGLE, "Turn counts", ICON_LIST, 0 };
        r[n++] = (row_def_t){ T_QUICKMENU, K_TOGGLE, "Quick menu moves", ICON_PLAY, 0 };
        r[n++] = (row_def_t){ T_SETTLEFULL, K_TOGGLE, "Full redraw on settle", ICON_SUN, 0 };
        r[n++] = (row_def_t){ V_KEYS, K_VALUE, "Brightness", ICON_SUN, 0 };
        r[n++] = (row_def_t){ C_KEYCOL, K_CHOICE, "Key colour", ICON_KEYBOARD, 0 };
        r[n++] = (row_def_t){ C_MENUCOL, K_CHOICE, "Menu key colour", ICON_KEYBOARD, 0 };
        r[n++] = (row_def_t){ T_KNOB, K_TOGGLE, "Knob light", ICON_SUN, 0 };
        break; }
    case N_KEY:
        r[n++] = (row_def_t){ C_KEY_PRESS, K_CHOICE, "Press", ICON_KEYBOARD, s_ki };
        r[n++] = (row_def_t){ C_KEY_HOLD, K_CHOICE, "Hold", ICON_KEYBOARD, s_ki };
        break;
    case N_SOFTWARE: {
        static char lab[OTA_REL_MAX][32];
        r[n++] = (row_def_t){ I_FWVER, K_INFO, "Installed", ICON_GEAR, 0 };
        r[n++] = (row_def_t){ A_OTACHECK, K_ACTION, "Check for updates", ICON_WIFI_HIGH, 0 };
        r[n++] = (row_def_t){ T_AUTOUPD, K_TOGGLE, "Auto-update overnight", ICON_MOON, 0 };
        for (int i = 0; i < ota_release_count() && n < 15; i++) {
            const ota_release_t *e = ota_release(i);
            snprintf(lab[i], sizeof lab[i], "%s%s", e->tag, e->pre ? " (pre)" : "");
            r[n++] = (row_def_t){ A_RELEASE, K_ACTION, lab[i], ICON_HOUSE, i };
        }
        break; }
    case N_TIMEG:
        r[n++] = (row_def_t){ T_AUTOTIME, K_TOGGLE, "Set automatically", ICON_WIFI_HIGH, 0 };
        r[n++] = (row_def_t){ C_TZ, K_CHOICE, "Time zone", ICON_HOUSE, 0 };
        r[n++] = (row_def_t){ V_TIME, K_VALUE, "Time", ICON_ALARM, 0 };
        r[n++] = (row_def_t){ V_DATE, K_VALUE, "Date", ICON_CALENDAR_BLANK, 0 };
        r[n++] = (row_def_t){ C_CLOCK, K_CHOICE, "Clock", ICON_ALARM, 0 };
        r[n++] = (row_def_t){ C_SNOOZE, K_CHOICE, "Snooze", ICON_BELL_RINGING, 0 };
        break;
    case N_DEVICE:
        r[n++] = (row_def_t){ S_SOFTWARE, K_SUB, "Software", ICON_GEAR, 0 };
        r[n++] = (row_def_t){ C_REFRESHMODE, K_CHOICE, "Screen updates", ICON_SUN, 0 };
        r[n++] = (row_def_t){ C_WFTEMP, K_CHOICE, "Waveform temp", ICON_THERMOMETER, 0 };
        r[n++] = (row_def_t){ A_REFRESH, K_ACTION, "Refresh screen", ICON_HOUSE, 0 };
        r[n++] = (row_def_t){ I_STATUS, K_INFO, "Status", ICON_PLUG, 0 };
        r[n++] = (row_def_t){ T_SPEAKER, K_TOGGLE, "Speaker", ICON_SPEAKER_HIGH, 0 };
        r[n++] = (row_def_t){ T_POWERMON, K_TOGGLE, "Battery backup", ICON_BATTERY_CHARGING, 0 };
        r[n++] = (row_def_t){ A_WIFISETUP, K_ACTION, "Wi-Fi setup", ICON_WIFI_HIGH, 0 };
        r[n++] = (row_def_t){ A_RESTART, K_ACTION, "Restart", ICON_PLUG, 0 };
        r[n++] = (row_def_t){ C_RESET, K_CHOICE, "Reset everything", ICON_TRASH, 0 };
        break;
    default: break;
    }
    r[n++] = (row_def_t){ R_BACK, K_BACK, "Back", ICON_ARROW_U_UP_LEFT, 0 };
    return n;
}
static const char *node_title(node_t nd)
{
    static char b[24];
    switch (nd) {
    case N_ROOT: return "Menu"; case N_RAIN: return "Sound"; case N_LIGHTS: return "Lights"; case N_AC: return "A/C";
    case N_ALARMS: return "Alarms"; case N_SETTINGS: return "Settings"; case N_CHORUS: return "Dawn chorus";
    case N_ALARM: snprintf(b, sizeof b, "Alarm %d", s_ai + 1); return b;
    case N_DAYS:  snprintf(b, sizeof b, "Alarm %d days", s_ai + 1); return b;
    case N_HOMESCR: return "Home screen"; case N_NIGHTG: return "Night"; case N_KEYS: return "Keys and knob";
    case N_KEY:   snprintf(b, sizeof b, "Key %d", s_ki + 1); return b;
    case N_TIMEG: return "Time and clock"; case N_DEVICE: return "Device"; case N_SOFTWARE: return "Software";
    default: return "";
    }
}

static struct { node_t node; int sel; } s_stack[6];
static int  s_depth;
static item_t s_edit;
static int  s_csel;
static char s_edit_label[24];

screen_t local_screen(void)
{
    if (s_mode == M_HOME) return SCR_HOME;
    switch (s_stack[s_depth - 1].node) {
    case N_RAIN: return SCR_RAIN; case N_LIGHTS: return SCR_LIGHTS; case N_AC: return SCR_AC;
    case N_ALARMS: case N_ALARM: case N_DAYS: case N_CHORUS: return SCR_ALARM; case N_SETTINGS: case N_HOMESCR: case N_NIGHTG: case N_KEYS: case N_KEY: case N_TIMEG: case N_DEVICE: case N_SOFTWARE: return SCR_SETTINGS;
    default: return SCR_MENU;
    }
}

/* ---- the model behind the rows ---- */
static const char *const SLEEPS[4]  = { "Off", "15 min", "30 min", "60 min" };
static const int SLEEP_V[4] = { 0, 15, 30, 60 };
static const char *const COLOURS[2] = { "Warm", "Night" };
static const char *const MODES4[4]  = { "Cool", "Heat", "Fan", "Dry" };
static const int MODE_V[4] = { 3, 1, 2, 4 };
static const char *const EARLY[5]   = { "Off", "5 min", "10 min", "15 min", "30 min" };
static const int EARLY_V[5] = { 0, 5, 10, 15, 30 };

static bool toggle_get(const row_def_t *r)
{
    switch (r->id) {
    case T_RAIN: return S.rain_on; case T_LIGHTS: return S.lights_on; case T_AC: return S.ac_mode != 0;
    case T_ALARM_ON: return s_alarms[r->arg].on; case T_DAY: return s_alarms[s_ai].days[r->arg];
    case T_BIRD: return (S.birds >> r->arg) & 1;
    case T_KNOB: return S.knob_light;
    case T_SHOW: return (S.show >> r->arg) & 1;
    case T_AUTOTIME: return S.auto_time;
    case T_AUTOUPD: return S.auto_update;
    case T_SPEAKER: return S.speaker; case T_POWERMON: return S.power_mon;
    case T_TURNHINTS: return S.turn_hints; case T_QUICKMENU: return S.quick_menus; case T_SETTLEFULL: return S.settle_full;
    case T_NIGHT: return S.night; default: return false;
    }
}
static void toggle_flip(const row_def_t *r)
{
    switch (r->id) {
    case T_RAIN:   S.rain_on = !S.rain_on; publish("set/rain", S.rain_on ? "play" : "pause"); break;
    case T_LIGHTS: S.lights_on = !S.lights_on; publish("set/lights", S.lights_on ? "on %d%%" : "off", S.bright); break;
    case T_AC:     S.ac_mode = S.ac_mode ? 0 : 3; publish("set/ac", "%s", AC_MODES[S.ac_mode]); break;
    case T_ALARM_ON: s_alarms[r->arg].on = !s_alarms[r->arg].on; publish_alarm(r->arg); sync_alarm_summary(); break;
    case T_DAY:    s_alarms[s_ai].days[r->arg] ^= 1; publish_alarm(s_ai); sync_alarm_summary(); break;
    case T_KNOB:   S.knob_light = !S.knob_light; apply_colours(); break;
    case T_SHOW:   S.show ^= 1 << r->arg; overlay_apply(); break;
    case T_AUTOUPD: S.auto_update = !S.auto_update; break;
    case T_SPEAKER: S.speaker = !S.speaker; publish("config/speaker", S.speaker ? "on" : "off"); break;
    case T_TURNHINTS: S.turn_hints = !S.turn_hints; break;
    case T_QUICKMENU: S.quick_menus = !S.quick_menus; break;
    case T_SETTLEFULL: S.settle_full = !S.settle_full; break;
    case T_POWERMON: S.power_mon = !S.power_mon; if (!S.power_mon) S.on_battery = false; break;
    case T_AUTOTIME: S.auto_time = !S.auto_time; if (!S.auto_time) manual_start(); rebuild(); break;
    case T_BIRD:   S.birds ^= (uint16_t)(1u << r->arg);
                   if ((S.birds >> r->arg) & 1) { S.audition_bird = r->arg; S.audition++; }   /* let you hear who you added */
                   break;
    case T_NIGHT:  S.night = !S.night; inputs_set_night(S.night); config_set_lights(inputs_backlight(), S.night); config_save();
                   publish("config/night", S.night ? "on" : "off"); break;
    default: break;
    }
}
static const row_def_t R_T_RAIN = { T_RAIN, K_TOGGLE, "Rain", NULL, 0 }, R_T_LIGHTS = { T_LIGHTS, K_TOGGLE, "Lights", NULL, 0 },
                       R_T_AC = { T_AC, K_TOGGLE, "A/C", NULL, 0 }, R_T_NIGHT = { T_NIGHT, K_TOGGLE, "Night", NULL, 0 };

typedef struct { int v, min, max, step; const char *lo, *hi; bool wrap; } vmeta_t;
static vmeta_t value_meta(item_t id)
{
    switch (id) {
    case V_RAIN_LVL:   return (vmeta_t){ S.rain_lvl, 1, 5, 1, "Drizzle", "Downpour", false };
    case V_BRIGHT:     return (vmeta_t){ S.bright, 5, 100, 5, "Dim", "Bright", false };
    case V_SETPOINT:   return (vmeta_t){ S.sp_x2, 32, 60, 1, "16" DEG, "30" DEG, false };
    case V_ALARM_TIME: return (vmeta_t){ s_alarms[s_ai].h * 60 + s_alarms[s_ai].m, 0, 1439, 5, "00:00", "23:59", true };
    case V_KEYS:       return (vmeta_t){ inputs_backlight() * 100 / 255, 0, 100, 10, "Off", "Bright", false };
    case V_BIRD_VOL:   return (vmeta_t){ S.bird_vol, 1, 10, 1, "Soft", "Loud", false };
    case V_TIME:       { int wd, sec; int64_t mn; int v = clock_now(&wd, &sec, &mn) ? sec / 60 : 0;
                         return (vmeta_t){ v, 0, 1439, 1, "00:00", "23:59", true }; }
    case V_DATE:       return (vmeta_t){ s_man_days, -3650, 3650, 1, "", "", false };
    default:           return (vmeta_t){ 0, 0, 1, 1, "", "", false };
    }
}
static void value_text(item_t id, char *b, size_t n)
{
    switch (id) {
    case V_RAIN_LVL:   snprintf(b, n, "%d of 5", S.rain_lvl); break;
    case V_BRIGHT:     snprintf(b, n, "%d%%", S.bright); break;
    case V_SETPOINT:   snprintf(b, n, "%d.%d" DEG, S.sp_x2 / 2, (S.sp_x2 % 2) * 5); break;
    case V_ALARM_TIME: snprintf(b, n, "%02d:%02d", s_alarms[s_ai].h, s_alarms[s_ai].m); break;
    case V_KEYS:       snprintf(b, n, "%d%%", inputs_backlight() * 100 / 255); break;
    case V_BIRD_VOL:   snprintf(b, n, "%d of 10", S.bird_vol); break;
    case V_TIME:       { int wd, sec; int64_t mn; if (clock_now(&wd, &sec, &mn)) fmt_hm(b, n, sec / 60); else snprintf(b, n, "--:--"); } break;
    case V_DATE:       { int y, m, d, wd; if (local_ymd(&y, &m, &d, &wd)) snprintf(b, n, "%.3s %d %.3s", DAY_NAMES[wd], d, MONTHS[m - 1]); else snprintf(b, n, "--"); } break;
    default:           b[0] = 0; break;
    }
}
/* d is the number of detents (signed); accel scales the step for fast turns. */
static void value_step(item_t id, int d, int accel)
{
    vmeta_t m = value_meta(id);
    int v = m.v + d * m.step * accel;
    if (m.wrap) { int span = m.max - m.min + 1; v = ((v - m.min) % span + span) % span + m.min; v -= v % m.step; }
    else v = clampi(v, m.min, m.max);
    switch (id) {
    case V_RAIN_LVL:   S.rain_lvl = v; publish("set/rain", "level %d", v); break;
    case V_BRIGHT:     S.bright = v; S.lights_on = true; publish("set/lights", "on %d%%", v); break;
    case V_SETPOINT:   S.sp_x2 = v; if (!S.ac_mode) S.ac_mode = 3; publish("set/ac", "%d.%d", v / 2, (v % 2) * 5); break;
    case V_ALARM_TIME: s_alarms[s_ai].h = v / 60; s_alarms[s_ai].m = v % 60; sync_alarm_summary(); break;
    case V_BIRD_VOL:   S.bird_vol = v; S.audition_bird = BIRD_MAGPIE; S.audition++; break;   /* a call at the new level */
    case V_KEYS:       { uint8_t lv = (uint8_t)(v * 255 / 100); inputs_set_backlight(lv); config_set_lights(lv, S.night); config_save(); } break;
    case V_TIME:       { int delta = v - m.v; if (delta > 720) delta -= 1440; if (delta < -720) delta += 1440;
                         s_man_base += (int64_t)delta * 60; rebuild(); } break;
    case V_DATE:       s_man_base += (int64_t)(v - s_man_days) * 86400; s_man_days = v; rebuild(); break;
    default: break;
    }
}
static int choice_opts(item_t id, const char *const **o)
{
    switch (id) {
    case C_RAIN_KIND: *o = KINDS; return 5;   case C_SLEEP: *o = SLEEPS; return 4;
    case C_COLOUR:    *o = COLOURS; return 2; case C_AC_MODE: *o = MODES4; return 4;
    case C_FAN:       *o = FANS; return 4;    case C_EARLY: *o = EARLY; return 5;
    case C_DASH:      if (!tesserae_pick_count()) { *o = DASHES; return 3; }      /* no list (older server): the rotation */
                      *o = dash_opts(); return 1 + tesserae_pick_count();
    case C_SURFACE:   *o = SURFACES; return 4;
    case C_KEYCOL: case C_MENUCOL: case C_NIGHTCOL: *o = PAL_NAMES; return N_PAL;
    case C_AUTONIGHT: *o = AUTONIGHT; return 4;
    case C_CLOCK:     *o = CLOCKF; return 2;
    case C_SNOOZE:    *o = SNOOZES; return 4;
    case C_RESET:     *o = RESETS; return 2;
    case C_THUNDER:   *o = THUNDERS; return 3;
    case C_OVERLAY:   *o = OVERLAYS; return 4;
    case C_ATNIGHT:   *o = ATNIGHT; return 2;
    case C_NIGHTKEYS: *o = NIGHTKEYS; return 2;
    case C_KEY_PRESS: case C_KEY_HOLD: *o = KEYACT_NAME; return N_KEYACT;
    case C_KNOB_HOLD: *o = KNOBACT_NAME; return N_KNOBACT;
    case C_TZ:        *o = TZ_NAMES; return N_TZ;
    case C_REFRESHMODE: *o = REFRESHES; return 3;
    case C_WFTEMP:    *o = WFTEMPS; return N_WFTEMP;
    default: *o = NULL; return 0;
    }
}
static int choice_get(item_t id)
{
    switch (id) {
    case C_RAIN_KIND: return S.rain_kind;
    case C_SLEEP:     for (int i = 0; i < 4; i++) if (SLEEP_V[i] == S.sleep_min) return i; return 0;
    case C_COLOUR:    return S.light_mode;
    case C_AC_MODE:   for (int i = 0; i < 4; i++) if (MODE_V[i] == S.ac_mode) return i; return 0;
    case C_FAN:       return S.fan;
    case C_EARLY:     for (int i = 0; i < 5; i++) if (EARLY_V[i] == s_alarms[s_ai].early) return i; return 3;
    case C_DASH:      return tesserae_pick_count() ? (S.dash_page == 0 ? 0 : s_dash_sel) : S.dash_page;
    case C_SURFACE:   return S.surface;
    case C_KEYCOL:    return S.key_col;
    case C_MENUCOL:   return S.menu_col;
    case C_NIGHTCOL:  return S.night_col;
    case C_AUTONIGHT: return S.auto_night;
    case C_CLOCK:     return S.clock12 ? 1 : 0;
    case C_SNOOZE:    for (int i = 0; i < 4; i++) if (SNOOZE_V[i] == S.snooze_min) return i; return 1;
    case C_RESET:     return 0;
    case C_THUNDER:   return !S.thunder ? 0 : S.thunder_near < 50 ? 1 : 2;
    case C_OVERLAY:   return S.overlay;
    case C_ATNIGHT:   return S.at_night;
    case C_NIGHTKEYS: return S.night_keys;
    case C_KEY_PRESS: case C_KEY_HOLD: {
        const char *b = config_get()->bind[(id == C_KEY_HOLD ? CONFIG_BIND_KEY1_HOLD : CONFIG_BIND_KEY1) + s_ki];
        for (int i = 0; i < N_KEYACT; i++) if (!strcmp(b, KEYACT_ID[i])) return i;
        return -1; }                                        /* something set from the web app */
    case C_KNOB_HOLD: {
        const char *b = config_get()->bind[CONFIG_BIND_KNOB_HOLD];
        for (int i = 0; i < N_KNOBACT; i++) if (!strcmp(b, KNOBACT_ID[i])) return i;
        return b[0] ? -1 : 0; }
    case C_TZ:        return S.tz;
    case C_REFRESHMODE: return S.refresh_mode;
    case C_WFTEMP: { for (int i = 0; i < N_WFTEMP; i++) if (WFTEMP_V[i] == S.wf_temp) return i; return 0; }
    default:          return 0;
    }
}
static void choice_set(item_t id, int k)
{
    switch (id) {
    case C_RAIN_KIND: S.rain_kind = k; S.rain_on = true; publish("set/rain", "%s", KINDS[k]); break;
    case C_SLEEP:     S.sleep_min = SLEEP_V[k]; publish("set/rain", "sleep %d", S.sleep_min); break;
    case C_COLOUR:    S.light_mode = k; S.lights_on = true; publish("set/lights", "%s", k ? "night" : "warm"); break;
    case C_AC_MODE:   S.ac_mode = MODE_V[k]; publish("set/ac", "%s", AC_MODES[S.ac_mode]); break;
    case C_FAN:       S.fan = k; publish("set/ac", "fan %s", FANS[k]); break;
    case C_EARLY:     s_alarms[s_ai].early = EARLY_V[k]; publish_alarm(s_ai); sync_alarm_summary(); break;
    case C_DASH:      if (!tesserae_pick_count()) { dash_go(k); break; }
                      if (k == 0) { dash_go(0); s_dash_sel = 0; break; }
                      dash_pick(k); break;
    case C_SURFACE:   S.surface = k; S.rain_on = true; publish("set/rain", "surface %s", SURFACES[k]); break;
    case C_KEYCOL:    S.key_col = k; apply_colours(); break;
    case C_MENUCOL:   S.menu_col = k; apply_colours(); break;
    case C_NIGHTCOL:  S.night_col = k; apply_colours(); break;
    case C_AUTONIGHT: S.auto_night = k; break;
    case C_CLOCK:     S.clock12 = k == 1; break;
    case C_SNOOZE:    S.snooze_min = SNOOZE_V[k]; break;
    case C_RESET:     if (k == 1) { printf("local: master reset asked for\n"); s_req = LREQ_RESET; } break;
    case C_OVERLAY:   S.overlay = k; overlay_apply(); break;
    case C_ATNIGHT:   S.at_night = k; break;
    case C_NIGHTKEYS: S.night_keys = k; apply_colours(); break;
    case C_KEY_PRESS: case C_KEY_HOLD:
        config_set_bind((id == C_KEY_HOLD ? CONFIG_BIND_KEY1_HOLD : CONFIG_BIND_KEY1) + s_ki, KEYACT_ID[k]); config_save(); break;
    case C_KNOB_HOLD: config_set_bind(CONFIG_BIND_KNOB_HOLD, KNOBACT_ID[k]); config_save(); break;
    case C_TZ:        S.tz = k; rebuild(); break;
    case C_REFRESHMODE: S.refresh_mode = k; s_req = LREQ_REFRESH; break;   /* one clean refresh now */
    case C_WFTEMP:      S.wf_temp = WFTEMP_V[k]; s_req = LREQ_REFRESH; break;
    case C_THUNDER:   if (k == 0) S.thunder = 0;
                      else if (k == 1) { if (!S.thunder) S.thunder = 35; S.thunder_near = 20; }
                      else { if (S.thunder < 60) S.thunder = 70; S.thunder_near = 75; }
                      publish("set/rain", "thunder %s", THUNDERS[k]); break;
    default: break;
    }
}
static void row_value(const row_def_t *r, char *b, size_t n)
{
    const char *const *o;
    b[0] = 0;
    switch (r->kind) {
    case K_TOGGLE: snprintf(b, n, "%s", toggle_get(r) ? "On" : "Off"); break;
    case K_VALUE:  value_text(r->id, b, n); break;
    case K_CHOICE: { if (r->id == C_RESET) break;
                     if (r->id == C_DASH && tesserae_pick_count() && S.dash_page) { snprintf(b, n, "%s", tesserae_pick_title(s_dash_sel - 1 >= 0 ? s_dash_sel - 1 : 0)); break; }
                     if (r->id == C_KEY_PRESS || r->id == C_KEY_HOLD) s_ki = r->arg;
                     int k = choice_opts(r->id, &o), c = choice_get(r->id);
                     if (k && c >= 0) snprintf(b, n, "%s", o[c]);
                     else if (r->id == C_KEY_PRESS || r->id == C_KEY_HOLD || r->id == C_KNOB_HOLD)
                         snprintf(b, n, "%s", action_name(config_get()->bind[r->id == C_KNOB_HOLD ? CONFIG_BIND_KNOB_HOLD
                                  : (r->id == C_KEY_HOLD ? CONFIG_BIND_KEY1_HOLD : CONFIG_BIND_KEY1) + r->arg])); } break;
    case K_INFO:
        if (r->id == I_VIEWPORT) { int x, y, w, h; viewport(&x, &y, &w, &h); snprintf(b, n, "%d x %d", w, h); }
        else if (r->id == I_FWVER) snprintf(b, n, "%s", FW_VERSION);
        else if (r->id == I_MENUKEY) snprintf(b, n, "Fixed");
        else if (S.on_battery) snprintf(b, n, "Battery %d%%", S.batt_pct);
        else snprintf(b, n, "Mains");
        break;
    case K_ACTION: if (r->id == A_PREVIEW && s_preview_len_ms) snprintf(b, n, "Playing");
                   if (r->id == A_OTACHECK && ota_checked_ms()) { int m = (int)((now_ms() - ota_checked_ms()) / 60000); if (m < 1) snprintf(b, n, "just now"); else snprintf(b, n, "%d min ago", m); }
                   if (r->id == A_RELEASE) { const ota_release_t *e = ota_release(r->arg); int c = e ? ota_version_cmp(e->ver, FW_VERSION) : 0;
                                             snprintf(b, n, "%s", !e ? "" : s_rel_armed == r->arg ? "Press again" : !strcmp(e->ver, FW_VERSION) ? "Installed" : c > 0 ? "Newer" : "Older"); }
                   break;
    case K_SUB:
        switch (r->id) {
        case S_RAIN:   if (S.rain_on) snprintf(b, n, "%s %d", KINDS[S.rain_kind], S.rain_lvl); else snprintf(b, n, "Off"); break;
        case S_LIGHTS: if (S.lights_on) snprintf(b, n, "%d%%", S.bright); else snprintf(b, n, "Off"); break;
        case S_AC:     if (S.ac_mode) snprintf(b, n, "%s %d" DEG, AC_MODES[S.ac_mode], S.sp_x2 / 2); else snprintf(b, n, "Off"); break;
        case S_ALARMS: { int on = 0; for (int i = 0; i < s_nalarms; i++) on += s_alarms[i].on;
                         if (on) snprintf(b, n, "%d on", on); else snprintf(b, n, "Off"); } break;
        case S_ALARM_ITEM: { const alarm_t *a = &s_alarms[r->arg]; char d[32]; alarm_days_txt(a, d, sizeof d);
                         if (a->on) snprintf(b, n, "%.23s", d); else snprintf(b, n, "Off"); } break;
        case S_DAYS:   alarm_days_txt(&s_alarms[s_ai], b, n); break;
        case S_CHORUS: { int k = 0; for (int i = 0; i < BIRD_COUNT; i++) k += (S.birds >> i) & 1;
                         if (k) snprintf(b, n, "%d birds", k); else snprintf(b, n, "Off"); } break;
        case S_HOMESCR: snprintf(b, n, "%s", OVERLAYS[ov_kind()]); break;
        case S_NIGHTG:  snprintf(b, n, "%s", S.night ? "On" : S.auto_night ? AUTONIGHT[S.auto_night] : "Off"); break;
        case S_KEY:     snprintf(b, n, "%s", local_label_for_action(config_get()->bind[CONFIG_BIND_KEY1 + r->arg])); break;
        case S_TIMEG:   snprintf(b, n, "%s", S.auto_time ? (S.tz ? TZ_NAMES[S.tz] : "Automatic") : "Set by hand"); break;
        default: break;
        }
        break;
    default: break;
    }
}
static node_t sub_node(item_t id)
{
    switch (id) {
    case S_CHORUS: return N_CHORUS;
    case S_RAIN: return N_RAIN; case S_LIGHTS: return N_LIGHTS; case S_AC: return N_AC; case S_ALARMS: return N_ALARMS;
    case S_ALARM_ITEM: return N_ALARM; case S_DAYS: return N_DAYS;
    case S_HOMESCR: return N_HOMESCR; case S_NIGHTG: return N_NIGHTG; case S_KEYS: return N_KEYS; case S_KEY: return N_KEY;
    case S_TIMEG: return N_TIMEG; case S_DEVICE: return N_DEVICE; case S_SOFTWARE: return N_SOFTWARE;
    default: return N_SETTINGS;
    }
}

/* ---- key labels (fixed: the keys mean the same everywhere) ---- */
const char *local_label_for_action(const char *spec);
const char *local_key_label(int i)
{
    if (i < 0 || i > 3) return "";
    if (S.phase == PHASE_RINGING) return "Snooze";
    if (i == 3) return "Menu";
    return local_label_for_action(config_get()->bind[CONFIG_BIND_KEY1 + i]);
}

/* ---- date ------------------------------------------------------------------- */
void local_set_time(const char *iso)
{
    char own[16];
    if (S.tz || !S.auto_time) {                       /* the device's own zone or time: its own date */
        int y, m, d, wd;
        if (local_ymd(&y, &m, &d, &wd)) { snprintf(own, sizeof own, "%04d-%02d-%02d", y, m, d); iso = own; }
    }
    static const char *const DN[7] = { "Sunday", "Monday", "Tuesday", "Wednesday", "Thursday", "Friday", "Saturday" };
    static const char *const MN[12] = { "January", "February", "March", "April", "May", "June", "July",
                                        "August", "September", "October", "November", "December" };
    int y, m, d;
    if (!iso || sscanf(iso, "%d-%d-%d", &y, &m, &d) != 3) return;
    static const int t[] = { 0, 3, 2, 5, 0, 3, 5, 1, 4, 6, 2, 4 };
    int yy = y - (m < 3);
    int wd = (yy + yy / 4 - yy / 100 + yy / 400 + t[m - 1] + d) % 7;
    char b[40];
    snprintf(b, sizeof b, "%s %d %s", DN[wd], d, MN[(m - 1) % 12]);
    if (strcmp(b, s_date) != 0) { snprintf(s_date, sizeof s_date, "%s", b); rebuild(); mark(0, 0, 1080, TB_H, IT8951_MODE_GL16); }
}

/* ---- building ---- */
#define LIST_W   (W / 2)
#define LIST_Y   (TB_H + 14)
static int s_row_h = 116;              /* shrinks for long lists (the days) */
static int s_list_n;                   /* rows in the list on screen */

static void build_top(layer_t *l, bool inv)
{
    uint8_t fg = inv ? G_WHITE : G_BLACK, bg = inv ? G_BLACK : G_WHITE, dim = inv ? G_LIGHT : G_DARK;
    (void)dim;
    layer_reset(l, 0, 0, W, TB_H, bg);
    op_fill(l, 0, TB_H - 4, W, 4, inv ? G_DARK : G_BLACK);
    const char *title = "";
    if (S.phase == PHASE_RINGING) title = s_date;
    else if (s_mode == M_HOME) title = s_date;     /* which rotation page is showing is the server's to say */
    else if (s_mode == M_LIST) title = node_title(s_stack[s_depth - 1].node);
    else title = s_edit_label;
    op_text(l, MARGIN, 50, F_M, fg, title);
    /* the four keys: icons under the keys, MENU framed on the orange one */
    for (int i = 0; i < 4; i++) {
        int cx = KEY_CX[i];
        op_fill(l, cx - 2, 0, 4, 16, i == 3 ? fg : dim);
        if (i < 3) { const char *ic = action_icon(config_get()->bind[CONFIG_BIND_KEY1 + i]); if (ic) op_text_c(l, cx, 44, F_IM, dim, ic); }
        else { int tw = draw_font_w(F_LBL, "MENU"); op_frame(l, cx - tw / 2 - 18, 36, tw + 36, 60, 3, fg); op_text_c(l, cx, 45, F_LBL, fg, "MENU"); }
    }
}

/* ---- the status bar ------------------------------------------------------------
 * Left: what is playing (volume, sound). Right, right-aligned: tonight's settings
 * when they are set (sleep timer, alarm, A/C, lights), then the links (Home
 * Assistant, Wi-Fi). The unusual (night mode, battery, offline) only when true. */
static bool clock_now(int *wday, int *sec, int64_t *minute);
static int  sleep_left_s(void);
static bool next_alarm(int *idx, int32_t *delta_s);

static int sb_item_r(layer_t *l, int xr, int cy, const char *icon, const char *text, uint8_t fg)
{
    int tw = text && text[0] ? draw_font_w(F_LBL, text) : 0;
    int x = xr - tw;
    if (tw) op_text(l, x, cy - F_LBL->line_h / 2, F_LBL, fg, text);
    if (icon) { x -= (tw ? 14 : 0) + draw_font_w(F_I, icon); op_text(l, x, cy - F_I->line_h / 2, F_I, fg, icon); }
    return x;
}

static void build_status(layer_t *l, bool inv)
{
    uint8_t fg = inv ? G_WHITE : G_BLACK, bg = inv ? G_BLACK : G_WHITE, dim = inv ? G_LIGHT : 0x5, track = inv ? G_DARK : 0xD;
    layer_reset(l, 0, SB_Y, W, SB_H, bg);
    op_fill(l, 0, SB_Y, W, 3, inv ? G_DARK : G_BLACK);
    int cy = SB_Y + 3 + (SB_H - 3) / 2;
    char b[40];
    /* left: volume, then the sound */
    int x = MARGIN;
    op_text(l, x, cy - F_I->line_h / 2, F_I, fg, S.vol ? ICON_SPEAKER_HIGH : ICON_SPEAKER_SLASH);
    x += draw_font_w(F_I, ICON_SPEAKER_HIGH) + 16;
    op_rrect(l, x, cy - 4, 220, 8, 4, track);
    if (S.vol) op_rrect(l, x, cy - 4, 220 * S.vol / 10 < 8 ? 8 : 220 * S.vol / 10, 8, 4, fg);
    x += 220 + 16;
    snprintf(b, sizeof b, "%d", S.vol);
    op_text(l, x, cy - F_LBL->line_h / 2, F_LBL, fg, b);
    x += draw_font_w(F_LBL, b) + 48;
    if (S.rain_on) {
        op_text(l, x, cy - F_I->line_h / 2, F_I, fg, ICON_CLOUD_RAIN); x += draw_font_w(F_I, ICON_CLOUD_RAIN) + 14;
        snprintf(b, sizeof b, "%s %d", KINDS[S.rain_kind], S.rain_lvl);
    } else {
        op_text(l, x, cy - F_I->line_h / 2, F_I, dim, ICON_PAUSE); x += draw_font_w(F_I, ICON_PAUSE) + 14;
        snprintf(b, sizeof b, "Paused");
    }
    op_text(l, x, cy - F_LBL->line_h / 2, F_LBL, S.rain_on ? fg : dim, b);

    /* right, from the edge inwards */
    int xr = W - MARGIN;
    if (!net_connected()) xr = sb_item_r(l, xr, cy, ICON_WIFI_SLASH, "Offline", fg) - 30;
    else xr = sb_item_r(l, xr, cy, ICON_WIFI_HIGH, NULL, fg) - 30;
    if (ha_connected()) xr = sb_item_r(l, xr, cy, ICON_HOUSE, NULL, fg) - 30;
    op_fill(l, xr - 2, cy - 28, 2, 56, inv ? G_DARK : 0xC);
    xr -= 2 + 48;
    if (S.on_battery) { snprintf(b, sizeof b, "%d%%", S.batt_pct); xr = sb_item_r(l, xr, cy, ICON_BATTERY_CHARGING, b, fg) - 48; }
    if (S.night) xr = sb_item_r(l, xr, cy, ICON_MOON, NULL, dim) - 48;
    if (S.ac_mode) { snprintf(b, sizeof b, "%s %d" DEG, AC_MODES[S.ac_mode], S.sp_x2 / 2); xr = sb_item_r(l, xr, cy, ICON_SNOWFLAKE, b, fg) - 48; }
    if (S.alarm_on) { alarm_txt(b, sizeof b); xr = sb_item_r(l, xr, cy, ICON_ALARM, b, fg) - 48; }
    int left = sleep_left_s(), wd, sec; int64_t mn;
    if (left > 0 && clock_now(&wd, &sec, &mn)) {
        int end = (sec + left) / 60 % 1440;
        snprintf(b, sizeof b, "Stops %02d:%02d", end / 60, end % 60);
        xr = sb_item_r(l, xr, cy, ICON_TIMER, b, fg) - 48;
    }
    if (S.lights_on) { snprintf(b, sizeof b, "%d%%", S.bright); xr = sb_item_r(l, xr, cy, ICON_LIGHTBULB, b, fg) - 48; }
}

/* ---- the live dashboard (D1) -------------------------------------------------------
 * Panel coordinates. Header (clock, next alarm), the tonight timeline, then a
 * 4 x 2 bento of soft tiles; black only for what needs you. Values come from
 * live.c (Home Assistant) and the device's own state. */
#define LV_HEAD_Y    170
#define LV_HEAD_H    242
#define LV_TL_Y      442
#define LV_TL_H      126
#define LV_ROW1      590
#define LV_ROW2      934
#define LV_TILE_H    322
#define LV_COL_W     418
#define LV_GAP       22
#define LV_COL(i)    (MARGIN + (i) * (LV_COL_W + LV_GAP))
#define G_TILE       0xE

static const bfont_t *fit(const char *t, int w, const bfont_t *a, const bfont_t *b, const bfont_t *c)
{
    if (draw_font_w(a, t) <= w) return a;
    if (draw_font_w(b, t) <= w) return b;
    return c;
}

static bool is_num(const char *v)
{
    if (!*v) return false;
    char *e; strtod(v, &e);
    return e != v && (*e == 0 || *e == ' ');
}

/* "21.43" -> "21.4°", anything else as it came; "--" when unknown. */
static void fmt_temp(int slot, char *b, size_t n)
{
    const char *v = live_value(slot);
    if (!v[0]) { snprintf(b, n, "--"); return; }
    if (is_num(v)) { char d[16]; live_fmt_dec(d, sizeof d, strtod(v, NULL), strchr(v, '.') ? 1 : 0); snprintf(b, n, "%s" DEG, d); }
    else snprintf(b, n, "%s", v);
}

/* "unlocked" -> "Unlocked"; underscores to spaces. */
static void fmt_word(const char *v, char *b, size_t n)
{
    if (!v[0]) { snprintf(b, n, "--"); return; }
    size_t k = 0;
    for (; *v && k + 1 < n; v++) b[k++] = *v == '_' ? ' ' : *v;
    b[k] = 0;
    if (b[0] >= 'a' && b[0] <= 'z') b[0] = (char)(b[0] - 32);
}

static bool word_in(const char *v, const char *const *list)
{
    for (; *list; list++) if (!strcasecmp(v, *list)) return true;
    return false;
}

static void tile_head(layer_t *l, int x, int y, int w, int h, bool dark, const char *icon, const char *label)
{
    op_rrect(l, x, y, w, h, 32, dark ? G_BLACK : G_TILE);
    op_text(l, x + 40, y + 36, F_I, dark ? G_WHITE : G_BLACK, icon);
    op_text(l, x + 40 + draw_font_w(F_I, icon) + 14, y + 36, F_S, dark ? 0xD : 0x5, label);
}

/* Value and one line under it, anchored to the tile's bottom. Returns the value's top. */
static int tile_foot(layer_t *l, int x, int y, int w, int h, bool dark, const char *value, const bfont_t *vf, const char *sub)
{
    int ysub = y + h - 36 - F_LBL->line_h;
    int yval = ysub - 10 - vf->line_h + (vf->line_h - vf->ascent) / 2;
    op_text(l, x + 40, yval, vf, dark ? G_WHITE : G_BLACK, value);
    if (sub && sub[0]) op_text(l, x + 40, ysub, F_LBL, dark ? 0xD : 0x4, sub);
    (void)w;
    return yval;
}

static void tl_mark(layer_t *l, int cx, int align, const char *t, const char *label, bool big)
{
    /* align: 0 centre, 1 start (cx is the left edge), 2 end (cx is the right edge) */
    int r = big ? 13 : 9, ly = LV_TL_Y + 47 + 2;
    const bfont_t *ft = big ? F_LBL : F_S;
    int tw = draw_font_w(ft, t), lw = label && label[0] ? draw_font_w(F_S, label) : 0;
    int dot = align == 1 ? cx + r : align == 2 ? cx - r : cx;
    int tx = align == 1 ? cx : align == 2 ? cx - tw : cx - tw / 2;
    int lx = align == 1 ? cx : align == 2 ? cx - lw : cx - lw / 2;
    op_text(l, tx, LV_TL_Y, ft, G_BLACK, t);
    op_circle(l, dot, ly, r, G_BLACK);
    if (lw) op_text(l, lx, ly + r + 14, F_S, 0x4, label);
}

static void build_live(layer_t *l)
{
    layer_reset(l, 0, TB_H, W, SB_Y - TB_H, G_WHITE);
    char b[64], c[64];
    int wday = 0, sec = 0; int64_t minute = 0;
    bool have_clock = clock_now(&wday, &sec, &minute);

    /* header: clock | next alarm */
    if (!have_clock) snprintf(b, sizeof b, "--:--");
    else if (S.clock12) { int hh = sec / 3600 % 12; snprintf(b, sizeof b, "%d:%02d", hh ? hh : 12, sec / 60 % 60); }
    else snprintf(b, sizeof b, "%02d:%02d", sec / 3600, sec / 60 % 60);
    int base = LV_HEAD_Y + LV_HEAD_H - 8;
    op_text(l, MARGIN, base - clock214.ascent, &clock214, G_BLACK, b);
    int xd = MARGIN + draw_font_w(&clock214, "00:00") + 56;
    op_fill(l, xd, base - 132, 3, 130, 0xC);
    int xa = xd + 3 + 56;
    int ai; int32_t delta;
    bool alarm = next_alarm(&ai, &delta);
    op_text(l, xa, base - 140 - F_S->ascent, F_S, 0x5, "NEXT ALARM");
    if (alarm) {
        int h, m, on, mask, early;
        local_alarm_get(ai, &h, &m, &on, &mask, &early);
        snprintf(b, sizeof b, "%02d:%02d", h, m);
        op_text(l, xa, base - 58 - ui72.ascent, &ui72, G_BLACK, b);
        int mins = (delta + 59) / 60;
        static const char *const DAYF[7] = { "Monday", "Tuesday", "Wednesday", "Thursday", "Friday", "Saturday", "Sunday" };
        if (delta < 0) c[0] = 0;
        else if (mins >= 24 * 60) snprintf(c, sizeof c, "on %s", DAYF[(wday + (sec + delta) / 86400) % 7]);
        else if (mins >= 60) snprintf(c, sizeof c, "in %d h %d min", mins / 60, mins % 60); else snprintf(c, sizeof c, "in %d min", mins);
        op_text(l, xa + draw_font_w(&ui72, b) + 22, base - 58 - F_M->ascent, F_M, 0x4, c);
        int win = early > 0 ? early : 10, cm = ((h * 60 + m - win) % 1440 + 1440) % 1440;
        if (S.birds && S.rain_on) snprintf(c, sizeof c, "Dawn chorus from %02d:%02d " DOT " rain fades out", cm / 60, cm % 60);
        else if (S.birds) snprintf(c, sizeof c, "Dawn chorus from %02d:%02d", cm / 60, cm % 60);
        else snprintf(c, sizeof c, "Wake window from %02d:%02d", cm / 60, cm % 60);
        op_text(l, xa, base - F_LBL->ascent, F_I, 0x4, ICON_BIRD);
        op_text(l, xa + draw_font_w(F_I, ICON_BIRD) + 14, base - F_LBL->ascent, F_LBL, 0x4, c);
    } else {
        op_text(l, xa, base - 58 - ui72.ascent, &ui72, 0x5, "No alarm");
        op_text(l, xa, base - F_LBL->ascent, F_LBL, 0x4, "Set one from Menu, Alarms");
    }

    /* the tonight timeline: now -> sound stops -> (sleep) -> chorus -> sunrise -> alarm */
    int x0 = MARGIN, tw = W - 2 * MARGIN, ly = LV_TL_Y + 47;
#define TLX(p) (x0 + tw * (p) / 100)
    op_fill(l, x0, ly, TLX(22) - x0, 4, 0xC);
    op_fill(l, x0, ly, TLX(4) - x0, 4, G_BLACK);
    op_dash(l, TLX(22), ly, TLX(64) - TLX(22), 4, 14, 0xB);
    op_fill(l, TLX(64), ly, TLX(100) - TLX(64), 4, 0xC);
    {   /* "Sleep" over the dashes */
        int sw = draw_font_w(F_I, ICON_MOON) + 10 + draw_font_w(F_S, "Sleep");
        int sx = TLX(43) - sw / 2;
        op_fill(l, sx - 16, ly - 24, sw + 32, 50, G_WHITE);
        op_text(l, sx, ly + 2 - F_I->line_h / 2, F_I, 0x5, ICON_MOON);
        op_text(l, sx + draw_font_w(F_I, ICON_MOON) + 10, ly + 2 - F_S->line_h / 2, F_S, 0x5, "Sleep");
    }
    tl_mark(l, x0, 1, "Now", "", false);
    int left = sleep_left_s();
    if (left > 0 && have_clock) {
        int end = (sec + left) / 60 % 1440;
        snprintf(b, sizeof b, "%02d:%02d", end / 60, end % 60);
        tl_mark(l, TLX(14), 0, b, S.rain_on ? "Sound stops" : "Timer ends", false);
    }
    if (alarm) {
        int h, m, on, mask, early;
        local_alarm_get(ai, &h, &m, &on, &mask, &early);
        int am = h * 60 + m, win = early > 0 ? early : 10, cm = ((am - win) % 1440 + 1440) % 1440;
        snprintf(b, sizeof b, "%02d:%02d", cm / 60, cm % 60);
        tl_mark(l, TLX(70), 0, b, S.birds ? "Chorus" : "Wake window", false);
        int y = 0, mo = 0, d = 0;
        if (sscanf(tesserae_local_time(), "%d-%d-%d", &y, &mo, &d) == 3) {
            int sr = live_sunrise_min(y, mo, d + (sec / 60 > am ? 1 : 0), tesserae_tz_offset_s());
            if (sr >= 0 && sr > cm && sr < am) { snprintf(b, sizeof b, "%02d:%02d", sr / 60, sr % 60); tl_mark(l, TLX(84), 0, b, "Sunrise", false); }
        }
        snprintf(b, sizeof b, "%02d:%02d", h, m);
        tl_mark(l, x0 + tw, 2, b, "Alarm", true);
    }
#undef TLX

    /* row 1: outside (wide), bedroom, washing */
    {   int x = LV_COL(0), y = LV_ROW1, w = 2 * LV_COL_W + LV_GAP, h = LV_TILE_H;
        tile_head(l, x, y, w, h, false, ICON_CLOUD_RAIN, "OUTSIDE");
        fmt_temp(LV_OUT_TEMP, b, sizeof b);
        op_text(l, x + 40, y + 80, F_XL, G_BLACK, b);                      /* temperature, baseline y + 172 */
        fmt_word(live_value(LV_OUT_COND), c, sizeof c);
        if (live_known(LV_OUT_COND)) op_text(l, x + 40, y + 222 - F_M->ascent, fit(c, 320, F_M, F_LBL, F_S), G_BLACK, c);
        char hi[16], lo[16]; fmt_temp(LV_OUT_HI, hi, sizeof hi); fmt_temp(LV_OUT_LO, lo, sizeof lo);
        if (live_known(LV_OUT_HI) || live_known(LV_OUT_LO)) { snprintf(c, sizeof c, "High %s " DOT " Low %s", hi, lo); op_text(l, x + 40, y + h - 36 - F_LBL->line_h, F_LBL, 0x4, c); }
        /* chance of rain, hourly */
        int rx = x + 40 + 320 + 44, rw = x + w - 40 - rx;
        const char *lab = "CHANCE OF RAIN, %";
        op_text(l, rx + rw - draw_font_w(F_S, lab), y + 36 + 4, F_S, 0x5, lab);
        int vals[8], nv = 0;
        for (const char *p = live_value(LV_RAIN); *p && nv < 8; ) {
            while (*p == ' ' || *p == ',' || *p == '[') p++;
            if (!*p || *p == ']') break;
            vals[nv++] = atoi(p);
            while (*p && *p != ',') p++;
        }
        int cw = (rw - 7 * 14) / 8, bottom = y + h - 36 - F_S->line_h - 10, maxh = 110;
        if (!nv) op_text(l, rx + rw - draw_font_w(F_LBL, "No forecast yet"), bottom - 60, F_LBL, 0x5, "No forecast yet");
        for (int i = 0; i < nv; i++) {
            int v = vals[i] < 0 ? 0 : vals[i] > 100 ? 100 : vals[i];
            int bh = v * maxh / 70; if (bh > maxh) bh = maxh; if (bh < 10) bh = 10;
            uint8_t g = v >= 60 ? 0x2 : v >= 40 ? 0x4 : v >= 25 ? 0x6 : v >= 15 ? 0x8 : v >= 8 ? 0xA : 0xB;
            int bx = rx + i * (cw + 14);
            op_rrect(l, bx, bottom - bh, cw, bh, 8, g);
            snprintf(c, sizeof c, "%d", v);
            op_text(l, bx + (cw - draw_font_w(F_S, c)) / 2, bottom - bh - 8 - F_S->line_h, F_S, 0x4, c);
            const char *hl = i == 0 ? "Now" : (snprintf(c, sizeof c, "%d", i), c);
            op_text(l, bx + (cw - draw_font_w(F_S, hl)) / 2, bottom + 8, F_S, 0x4, hl);
        }
    }
    {   int x = LV_COL(2), y = LV_ROW1, w = LV_COL_W, h = LV_TILE_H;
        tile_head(l, x, y, w, h, false, ICON_THERMOMETER, "BEDROOM");
        fmt_temp(LV_BED_TEMP, b, sizeof b);
        if (live_known(LV_BED_HUM)) snprintf(c, sizeof c, "Humidity %s%%", live_value(LV_BED_HUM)); else c[0] = 0;
        int top = tile_foot(l, x, y, w, h, false, b, F_XL, c);
        float hs[25]; int n = live_history(hs, 25);
        if (n >= 2) {                            /* the last 12 hours */
            float lo = hs[0], hi = hs[0];
            for (int i = 1; i < n; i++) { if (hs[i] < lo) lo = hs[i]; if (hs[i] > hi) hi = hs[i]; }
            if (hi - lo < 1.0f) { float mid = (hi + lo) / 2; lo = mid - 0.5f; hi = mid + 0.5f; }
            int sx = x + 40, sw = w - 80, sy = top - 6 - 60, sh = 52;
            for (int i = 1; i < n; i++) {
                int xa2 = sx + sw * (i - 1) / (n - 1), xb2 = sx + sw * i / (n - 1);
                int ya2 = sy + sh - (int)((hs[i - 1] - lo) / (hi - lo) * (float)sh);
                int yb2 = sy + sh - (int)((hs[i] - lo) / (hi - lo) * (float)sh);
                op_line(l, xa2, ya2, xb2, yb2, 4, G_BLACK);
            }
        }
    }
    {   int x = LV_COL(3), y = LV_ROW1, w = LV_COL_W, h = LV_TILE_H;
        static const char *const DONE[] = { "done", "finished", "complete", "completed", "end", NULL };
        const char *v = live_value(LV_WASHER);
        bool dark = word_in(v, DONE);
        tile_head(l, x, y, w, h, dark, ICON_WASHING_MACHINE, "WASHING");
        fmt_word(v, b, sizeof b);
        uint32_t age = live_age_s(LV_WASHER) / 60;
        if (!live_known(LV_WASHER)) c[0] = 0;
        else if (age < 1) snprintf(c, sizeof c, dark ? "Just now " DOT " hang it out" : "Just now");
        else if (age < 120) snprintf(c, sizeof c, dark ? "%lu min ago " DOT " hang it out" : "%lu min", (unsigned long)age);
        else snprintf(c, sizeof c, "%lu h ago", (unsigned long)(age / 60));
        tile_foot(l, x, y, w, h, dark, b, fit(b, w - 80, F_XL, &ui72, F_M), c);
    }

    /* row 2: security, bins, next event, A/C */
    {   int x = LV_COL(0), y = LV_ROW2, w = LV_COL_W, h = LV_TILE_H;
        static const char *const SHUT[] = { "locked", "closed", "off", "shut", NULL };
        static const int SL[3] = { LV_FRONT, LV_BACK, LV_GARAGE };
        static const char *const SN[3] = { "Front door", "Back door", "Garage" };
        int open = -1, known = 0;
        for (int i = 0; i < 3; i++) if (live_known(SL[i])) { known++; if (!word_in(live_value(SL[i]), SHUT) && open < 0) open = i; }
        bool dark = open >= 0;
        tile_head(l, x, y, w, h, dark, ICON_LOCK, "SECURITY");
        if (dark) { fmt_word(live_value(SL[open]), c, sizeof c); c[0] = (char)tolower((unsigned char)c[0]); snprintf(b, sizeof b, "%.20s %.30s", SN[open], c); }
        else snprintf(b, sizeof b, known ? "All shut" : "--");
        op_text(l, x + 40, y + 36 + 42 + 14, fit(b, w - 80, F_M, F_LBL, F_S), dark ? G_WHITE : G_BLACK, b);
        for (int i = 0; i < 3; i++) {
            int ry = y + h - 36 - F_S->line_h - (2 - i) * 44;
            bool ok = live_known(SL[i]) && word_in(live_value(SL[i]), SHUT);
            uint8_t fg = dark ? G_WHITE : G_BLACK;
            if (live_known(SL[i])) op_text(l, x + 40, ry + 1, F_I, fg, ok ? ICON_CHECK : ICON_BELL_RINGING);
            op_text(l, x + 40 + 34 + 12, ry, F_S, fg, SN[i]);
            fmt_word(live_value(SL[i]), c, sizeof c);
            op_text(l, x + w - 40 - draw_font_w(F_S, c), ry, F_S, dark ? 0xD : 0x4, c);
        }
    }
    {   int x = LV_COL(1), y = LV_ROW2, w = LV_COL_W, h = LV_TILE_H;
        tile_head(l, x, y, w, h, false, ICON_TRASH, "BINS");
        fmt_word(live_value(LV_BINS), b, sizeof b);
        tile_foot(l, x, y, w, h, false, b, fit(b, w - 80, &ui72, F_M, F_LBL), live_value(LV_BINS_WHEN));
    }
    {   int x = LV_COL(2), y = LV_ROW2, w = LV_COL_W, h = LV_TILE_H;
        tile_head(l, x, y, w, h, false, ICON_CALENDAR_BLANK, "NEXT EVENT");
        const char *v = live_value(LV_EVENT);
        int hh, mm;
        if (sscanf(v, "%d:%d", &hh, &mm) == 2 && strlen(v) >= 5) {
            snprintf(b, sizeof b, "%02d:%02d", hh, mm);
            const char *rest = v + 5; while (*rest == ' ' || *rest == '-') rest++;
            snprintf(c, sizeof c, "%.24s", rest);
            tile_foot(l, x, y, w, h, false, b, &ui72, c);
        } else {
            snprintf(b, sizeof b, "%.40s", v[0] ? v : "--");
            tile_foot(l, x, y, w, h, false, b, fit(b, w - 80, &ui72, F_M, F_LBL), "");
        }
    }
    {   int x = LV_COL(3), y = LV_ROW2, w = LV_COL_W, h = LV_TILE_H;
        tile_head(l, x, y, w, h, false, ICON_SNOWFLAKE, "A/C");
        if (S.ac_mode) snprintf(b, sizeof b, "%s %d" DEG, AC_MODES[S.ac_mode], S.sp_x2 / 2); else snprintf(b, sizeof b, "Off");
        char fan[8]; snprintf(fan, sizeof fan, "%s", FANS[S.fan]); fan[0] = (char)tolower((unsigned char)fan[0]);
        snprintf(c, sizeof c, "Room %d.%d" DEG " " DOT " fan %s", S.room_x10 / 10, S.room_x10 % 10, fan);
        tile_foot(l, x, y, w, h, false, b, fit(b, w - 80, &ui72, F_M, F_LBL), c);
    }
}

/* Which regions to repaint for a change of live slot s. */
static void live_mark_slot(int s)
{
    int x = 0, y = LV_ROW1, w = LV_COL_W;
    switch (s) {
    case LV_OUT_TEMP: case LV_OUT_COND: case LV_OUT_HI: case LV_OUT_LO: case LV_RAIN: x = LV_COL(0); w = 2 * LV_COL_W + LV_GAP; break;
    case LV_BED_TEMP: case LV_BED_HUM: x = LV_COL(2); break;
    case LV_WASHER: x = LV_COL(3); break;
    case LV_FRONT: case LV_BACK: case LV_GARAGE: x = LV_COL(0); y = LV_ROW2; break;
    case LV_BINS: case LV_BINS_WHEN: x = LV_COL(1); y = LV_ROW2; break;
    default: x = LV_COL(2); y = LV_ROW2; break;
    }
    mark(x, y, w, LV_TILE_H, IT8951_MODE_GL16);
}

static bool numeric(const char *t)
{
    for (; *t; t++) if (!strchr("0123456789:.%-Of" DEG, *t)) return false;
    return true;
}

/* A split list: rows on the left, the highlighted row large on the right. */
static void build_split(layer_t *l, const char *const *labels, const char *const *icons, char vals[][24],
                        const bool *chev, const bool *check, int n, int sel, const char *pv_icon, const char *pv_big, const char *pv_small)
{
    layer_reset(l, 0, TB_H, W, SB_Y - TB_H, G_WHITE);
    op_fill(l, LIST_W, TB_H, 3, SB_Y - TB_H, G_LIGHT);
    s_row_h = n > 8 ? (SB_Y - LIST_Y - 10) / n : 116;
    for (int i = 0; i < n; i++) {
        int y = LIST_Y + i * s_row_h;
        bool s = (i == sel);
        uint8_t fg = s ? G_WHITE : G_BLACK, dim = s ? G_LIGHT : G_DARK;
        if (s) op_fill(l, 0, y, LIST_W, s_row_h, G_BLACK);
        else op_fill(l, MARGIN, y + s_row_h - 2, LIST_W - MARGIN - 30, 2, G_LIGHT);
        int x = MARGIN;
        if (icons && icons[i]) { op_text(l, x, y + (s_row_h - F_IM->line_h) / 2, F_IM, dim, icons[i]); x += 80; }
        op_text(l, x, y + (s_row_h - F_M->line_h) / 2, F_M, fg, labels[i]);
        int xr = LIST_W - 40;
        if (chev && chev[i]) { xr -= draw_font_w(F_I, ICON_CARET_RIGHT); op_text(l, xr, y + (s_row_h - F_I->line_h) / 2, F_I, dim, ICON_CARET_RIGHT); xr -= 18; }
        if (check && check[i]) { xr -= draw_font_w(F_IM, ICON_CHECK); op_text(l, xr, y + (s_row_h - F_IM->line_h) / 2, F_IM, fg, ICON_CHECK); xr -= 18; }
        if (vals && vals[i][0]) op_text_r(l, xr, y + (s_row_h - F_LBL->line_h) / 2, F_LBL, dim, vals[i]);
        if (S.turn_hints && !s) {           /* turns from the highlighted row: clockwise is down */
            char t[8]; snprintf(t, sizeof t, "%+d", i - sel);
            op_text_r(l, MARGIN - 12, y + (s_row_h - F_S->line_h) / 2, F_S, G_DARK, t);
        }
    }
    s_list_n = n;
    int cx = LIST_W + (W - LIST_W) / 2, y = TB_H + 150;
    if (pv_icon) { op_text_c(l, cx, y, &icon170, G_BLACK, pv_icon); y += icon170.line_h + 30; }
    const bfont_t *bf = numeric(pv_big) && draw_font_w(F_NUM, pv_big) < W - LIST_W - 80 ? F_NUM : F_XL;
    if (draw_font_w(bf, pv_big) > W - LIST_W - 80) bf = F_M;
    op_text_c(l, cx, y, bf, G_BLACK, pv_big); y += bf->line_h + 18;
    op_text_c(l, cx, y, F_LBL, G_DARK, pv_small);
}

static void build_list(layer_t *l)
{
    node_t nd = s_stack[s_depth - 1].node;
    int n = node_rows(nd, s_rows), sel = s_stack[s_depth - 1].sel;
    if (sel >= n) sel = s_stack[s_depth - 1].sel = n - 1;
    const char *labels[16], *icons[16]; char vals[16][24]; bool chev[16];
    for (int i = 0; i < n; i++) {
        const row_def_t *r = &s_rows[i];
        labels[i] = r->label; icons[i] = r->icon; row_value(r, vals[i], 24);
        chev[i] = r->kind == K_SUB || r->kind == K_VALUE || r->kind == K_CHOICE;
    }
    const row_def_t *r = &s_rows[sel];
    char big[24]; snprintf(big, sizeof big, "%s", vals[sel][0] ? vals[sel] : r->label);
    const char *hint = r->kind == K_TOGGLE ? "press to switch" : r->kind == K_SUB ? "press to open" : r->kind == K_BACK ? "press to go back"
                     : r->kind == K_ACTION ? "press" : r->kind == K_INFO ? "" : "press to change";
    char small[48]; snprintf(small, sizeof small, "%s%s%s", r->kind == K_BACK ? "" : r->label, (hint[0] && r->kind != K_BACK) ? "  " DOT "  " : "", hint);
    if (r->kind == K_SUB && r->id == S_ALARM_ITEM) snprintf(big, sizeof big, "%s", r->label);
    if (r->id == I_STATUS) { if (S.on_battery) snprintf(big, sizeof big, "Battery %d%%", S.batt_pct); else snprintf(big, sizeof big, "Mains"); snprintf(small, sizeof small, "Wi-Fi %s " DOT " %s", net_connected() ? "on" : "off", tesserae_state_name()); }
    if (r->id == I_VIEWPORT) { int x, y, w, h; viewport(&x, &y, &w, &h); snprintf(small, sizeof small, "at x %d, y %d " DOT " every heartbeat", x, y); }
    if (r->id == I_MENUKEY) { snprintf(big, sizeof big, "Menu"); snprintf(small, sizeof small, "Press: menu or back " DOT " hold: home"); }
    if ((r->id == V_TIME || r->id == V_DATE) && S.auto_time) snprintf(small, sizeof small, "Set automatically " DOT " switch it off to change");
    if (r->id == C_OVERLAY) { int x, y, w, h; viewport(&x, &y, &w, &h); snprintf(small, sizeof small, "Dashboard %d x %d " DOT " press to change", w, h); }
    if (r->id == I_FWVER) { int sl = ota_boot_partition(); snprintf(small, sizeof small, "slot %c " DOT " from github.com/%s", sl >= 0 ? 'A' + sl : '-', "dmellok"); }
    if (r->id == A_OTACHECK) snprintf(small, sizeof small, "%d release(s) listed " DOT " press to check GitHub", ota_release_count());
    if (r->id == T_AUTOUPD) snprintf(small, sizeof small, "Newest stable, 03:10, never near an alarm");
    if (r->id == A_RELEASE) { const ota_release_t *e = ota_release(r->arg);
        if (e) snprintf(small, sizeof small, "%s " DOT " %s", e->date, s_rel_armed == r->arg ? "press again to install" : "press to install"); }
    if (r->id == A_WIFISETUP) snprintf(small, sizeof small, "Restarts into setup: join its WiFi from a phone");
    if (r->id == T_TURNHINTS) snprintf(small, sizeof small, "Beside each row: turns to reach it, + clockwise");
    if (r->id == T_QUICKMENU) snprintf(small, sizeof small, "Steps in black and white, full quality when you stop");
    if (r->id == T_SETTLEFULL) snprintf(small, sizeof small, "When you stop: the whole screen, cleared first " DOT " flashes");
    if (r->id == C_WFTEMP) { int s = it8951_temp_sensed(); if (s >= 0) snprintf(small, sizeof small, "Board sensor says %d C " DOT " lower = darker", s); else snprintf(small, sizeof small, "Lower = darker, higher = lighter"); }
    if (r->id == C_REFRESHMODE) snprintf(small, sizeof small, "%s", S.refresh_mode == 2 ? "Whole screen, every change " DOT " flashes"
                                                               : S.refresh_mode == 1 ? "Full quality, just what changed" : "Just what changed, a clean-up when you stop");
    if (r->id == C_KEY_PRESS || r->id == C_KEY_HOLD) snprintf(small, sizeof small, "Key %d, %s " DOT " press to change", s_ki + 1, r->id == C_KEY_HOLD ? "held" : "pressed");
    build_split(l, labels, icons, vals, chev, NULL, n, sel, r->icon, big, small);
}

static void build_choice(layer_t *l)
{
    const char *const *o; int n = choice_opts(s_edit, &o), cur = choice_get(s_edit);
    const char *labels[16], *icons[16]; bool check[16];
    for (int i = 0; i < n; i++) { labels[i] = o[i]; check[i] = (i == cur); icons[i] = NULL; }
    labels[n] = "Back"; check[n] = false; icons[n] = ICON_ARROW_U_UP_LEFT;
    bool back = s_csel == n;
    build_split(l, labels, icons, NULL, NULL, check, n + 1, s_csel, back ? ICON_ARROW_U_UP_LEFT : NULL,
                back ? "Back" : o[s_csel], back ? "press to go back" : "press to choose");
}

#define TRACK_X  (MARGIN + 180)
#define TRACK_W  (W - 2 * TRACK_X)
static void build_value(layer_t *l)
{
    layer_reset(l, 0, TB_H, W, SB_Y - TB_H, G_WHITE);
    vmeta_t m = value_meta(s_edit);
    char t[24]; value_text(s_edit, t, sizeof t);
    int y = TB_H + 60;
    const char *icon = s_edit == V_BIRD_VOL ? ICON_BIRD : s_edit == V_ALARM_TIME ? ICON_ALARM : s_edit == V_SETPOINT ? ICON_THERMOMETER : s_edit == V_RAIN_LVL ? ICON_CLOUD_RAIN : ICON_SUN;
    op_text_c(l, W / 2, y, &icon170, G_BLACK, icon);
    y += icon170.line_h + 20;
    op_text_c(l, W / 2, y, numeric(t) ? F_NUM : F_XL, G_BLACK, t);
    y = TB_H + 700;
    int fx = (int)((long)TRACK_W * (m.v - m.min) / (m.max - m.min ? m.max - m.min : 1));
    op_fill(l, TRACK_X, y, TRACK_W, 22, G_LIGHT);
    op_fill(l, TRACK_X, y, fx, 22, G_BLACK);
    op_circle(l, TRACK_X + fx, y + 11, 34, G_BLACK);
    op_circle(l, TRACK_X + fx, y + 11, 22, G_WHITE);
    op_text(l, TRACK_X, y + 60, F_LBL, G_DARK, m.lo);
    op_text_r(l, TRACK_X + TRACK_W, y + 60, F_LBL, G_DARK, m.hi);
    op_text_c(l, W / 2, y + 160, F_S, G_DARK, "turn to adjust, faster for bigger steps  " DOT "  press or MENU when done");
}

static void build_ring(layer_t *l)
{
    layer_reset(l, 0, TB_H, W, SB_Y - TB_H, G_BLACK);
    op_text_c(l, W / 2, TB_H + 90, F_M, G_LIGHT, "Good morning");
    char t[8]; alarm_txt(t, sizeof t);
    op_text_c(l, W / 2, TB_H + 200, F_HUGE, G_WHITE, t);
    op_text_c(l, W / 2, TB_H + 620, F_LBL, G_LIGHT, "Press the knob to stop  " DOT "  any key or a turn snoozes");
}


/* ---- the clock: the network's time, the server's zone, or the user's -------------
 * Automatic: UTC from the server's Date headers and Tesserae's UTC offset. A
 * chosen zone replaces the offset (with its daylight saving); switching
 * automatic off runs a clock set by hand from the board's timer. */
/* s_man_base: manual UTC = base + seconds since boot (declared above) */
static bool    s_man_set;
static const char *const MONTHS[12] = { "January", "February", "March", "April", "May", "June", "July",
                                        "August", "September", "October", "November", "December" };

static int64_t days_from_civil(int y, int m, int d)
{
    y -= m <= 2;
    int era = (y >= 0 ? y : y - 399) / 400, yoe = y - era * 400;
    int doy = (153 * (m + (m > 2 ? -3 : 9)) + 2) / 5 + d - 1, doe = yoe * 365 + yoe / 4 - yoe / 100 + doy;
    return (int64_t)era * 146097 + doe - 719468;
}
static void civil_from_days(int64_t z, int *y, int *m, int *d)
{
    z += 719468;
    int64_t era = (z >= 0 ? z : z - 146096) / 146097;
    int doe = (int)(z - era * 146097), yoe = (doe - doe / 1460 + doe / 36524 - doe / 146096) / 365;
    int doy = doe - (365 * yoe + yoe / 4 - yoe / 100), mp = (5 * doy + 2) / 153;
    *d = doy - (153 * mp + 2) / 5 + 1; *m = mp < 10 ? mp + 3 : mp - 9; *y = (int)(yoe + era * 400) + (*m <= 2);
}
static int64_t first_sunday(int y, int m)      /* day number */
{
    int64_t d = days_from_civil(y, m, 1); int wd = (int)((d % 7 + 7 + 3) % 7);   /* 0 = Monday */
    return d + (6 - wd + 7) % 7;
}
static int64_t last_sunday(int y, int m)
{
    int64_t d = days_from_civil(y, m + 1, 1) - 1; int wd = (int)((d % 7 + 7 + 3) % 7);
    return d - (wd + 1) % 7;
}
/* Daylight saving at local standard time lstd, southern rules (2 am standard). */
static bool dst_on(int64_t lstd, int rule)
{
    int y, m, d; civil_from_days(lstd >= 0 ? lstd / 86400 : (lstd - 86399) / 86400, &y, &m, &d);
    int64_t start = (rule == 2 ? last_sunday(y, 9) : first_sunday(y, 10)) * 86400 + 7200;
    int64_t end = first_sunday(y, 4) * 86400 + 7200;
    return lstd >= start || lstd < end;
}
static int32_t tz_offset_at(int64_t utc)
{
    if (S.tz <= 0 || S.tz >= N_TZ) return tesserae_tz_offset_s();
    const tzone_t *z = &TZONES[S.tz];
    return z->std_s + (z->dst && dst_on(utc + z->std_s, z->dst) ? 3600 : 0);
}
static int64_t utc_now(void)
{
    if (!S.auto_time && s_man_set) return s_man_base + (int64_t)(time_us_64() / 1000000u);
    return (int64_t)rest_epoch_now();
}
/* Automatic off: start the hand-set clock from the time now (or 1 Jan 2026). */
static void manual_start(void)
{
    uint32_t e = rest_epoch_now();
    s_man_base = (e ? (int64_t)e : 1767225600) - (int64_t)(time_us_64() / 1000000u);
    s_man_set = true; s_man_days = 0;
}
static bool local_ymd(int *y, int *m, int *d, int *wd)
{
    int64_t e = utc_now();
    if (!e) return false;
    int64_t l = e + tz_offset_at(e), days = l / 86400;
    civil_from_days(days, y, m, d);
    *wd = (int)((days + 3) % 7);                   /* 0 = Monday, as DAY_NAMES */
    return true;
}

/* ---- Mk II home: the dashboard and one overlay ------------------------------------
 * Persistent local UI lives only in the overlay: a strip along the bottom
 * (default), cards down the left, cards along the bottom, or nothing. What it
 * leaves is the dashboard's viewport, reported to Tesserae on every heartbeat.
 * Each item is one line: an icon and a value. Live (dashboard 0) keeps its own
 * full-screen layout. */
#define OV_STRIP_H   176
#define OV_LEFT_W    432
#define OV_BOTTOM_H  324
#define OV_PAD       34
#define CARD_GREY    0xD

/* The overlay in force: nothing to show means none. */
static int ov_kind(void) { return (S.show & 0x1F) ? S.overlay : 3; }
static bool ov_active(void) { return s_mode == M_HOME && S.dash_page > 0 && S.phase != PHASE_RINGING; }

static bool ov_rect(int *x, int *y, int *w, int *h)
{
    switch (ov_kind()) {
    case 0: *x = 0; *y = H - OV_STRIP_H; *w = W; *h = OV_STRIP_H; return true;
    case 1: *x = 0; *y = 0; *w = OV_LEFT_W; *h = H; return true;
    case 2: *x = 0; *y = H - OV_BOTTOM_H; *w = W; *h = OV_BOTTOM_H; return true;
    default: *x = *y = *w = *h = 0; return false;
    }
}
static void viewport(int *x, int *y, int *w, int *h)
{
    switch (ov_kind()) {
    case 0: *x = 0; *y = 0; *w = W; *h = H - OV_STRIP_H; break;
    case 1: *x = OV_LEFT_W; *y = 0; *w = W - OV_LEFT_W; *h = H; break;
    case 2: *x = 0; *y = 0; *w = W; *h = H - OV_BOTTOM_H; break;
    default: *x = 0; *y = 0; *w = W; *h = H; break;
    }
}
/* An op's footprint on the panel. */
static void op_bbox(const op_t *o, int *x, int *y, int *w, int *h)
{
    switch (o->kind) {
    case OP_CIRCLE: case OP_RING: *x = o->x - o->w; *y = o->y - o->w; *w = 2 * o->w + 2; *h = 2 * o->w + 2; break;
    case OP_LINE: { int x0 = o->w < 0 ? o->x + o->w : o->x, y0 = o->h < 0 ? o->y + o->h : o->y;
                    *x = x0 - o->border; *y = y0 - o->border; *w = (o->w < 0 ? -o->w : o->w) + 2 * o->border + 1; *h = (o->h < 0 ? -o->h : o->h) + 2 * o->border + 1; break; }
    default: *x = o->x; *y = o->y; *w = o->w; *h = o->h; break;
    }
}
/* Mark what changed between two builds of a layer: the footprint of every op
 * that differs, old and new. If the layers don't line up (a different number
 * of ops, another region), fall back to the whole rect given. */
static void mark_changed(const layer_t *prev, const layer_t *now, int fx, int fy, int fw, int fh, uint8_t mode)
{
    if (prev->n != now->n || prev->x != now->x || prev->y != now->y || prev->w != now->w || prev->h != now->h || prev->on != now->on || prev->bg != now->bg) {
        mark(fx, fy, fw, fh, mode); return;
    }
    int changed = 0;
    for (int i = 0; i < now->n; i++) {
        const op_t *a = &prev->ops[i], *b = &now->ops[i];
        if (a->kind == b->kind && a->g == b->g && a->border == b->border && a->font == b->font && a->x == b->x && a->y == b->y &&
            a->w == b->w && a->h == b->h && !strcmp(a->text, b->text)) continue;
        int x, y, w, h;
        op_bbox(a, &x, &y, &w, &h); mark(x - 4, y - 4, w + 8, h + 8, mode);
        op_bbox(b, &x, &y, &w, &h); mark(x - 4, y - 4, w + 8, h + 8, mode);
        changed++;
    }
    (void)changed;
}
static void mark_ov(void) { int x, y, w, h; if (ov_rect(&x, &y, &w, &h)) mark_changed(&s_prev_sb, &L_sb, x, y, w, h, IT8951_MODE_GL16); }
/* The overlay settings changed: tell Tesserae what the dashboard has now. */
static void overlay_apply(void)
{
    int x, y, w, h; viewport(&x, &y, &w, &h);
    tesserae_set_viewport(x, y, w, h);
}

static void fmt_hm(char *b, size_t n, int mins)
{
    int h = mins / 60 % 24, m = mins % 60;
    if (S.clock12) snprintf(b, n, "%d:%02d", h % 12 ? h % 12 : 12, m);
    else snprintf(b, n, "%02d:%02d", h, m);
}

/* One overlay item: icon and value (and an optional dim tail), drawn from x
 * with its vertical centre at cy. Returns the x after it. */
static int ov_item(layer_t *l, int x, int cy, const char *icon, const char *val, const char *tail, uint8_t fg, uint8_t dim, const bfont_t *f)
{
    if (icon) { op_text(l, x, cy - F_IM->line_h / 2, F_IM, dim, icon); x += draw_font_w(F_IM, icon) + 18; }
    if (val && val[0]) { op_text(l, x, cy - f->line_h / 2, f, fg, val); x += draw_font_w(f, val); }
    if (tail && tail[0]) { x += 18; op_text(l, x, cy - f->line_h / 2, f, dim, tail); x += draw_font_w(f, tail); }
    return x;
}

typedef struct { const char *icon; char val[16]; char tail[8]; } ov_val_t;
/* The values the overlay shows, in order; returns how many (clock first when shown). */
static int ov_values(ov_val_t *v, bool *clock, char *clk, char *clock_ampm, char *date)
{
    int n = 0, wd, sec; int64_t mn;
    bool have = clock_now(&wd, &sec, &mn);
    bool solo = S.night && S.at_night == 1;
    *clock = (S.show & 1) != 0;
    clock_ampm[0] = 0;
    if (have) {
        int m = sec / 60;
        fmt_hm(clk, 8, m);
        if (S.clock12) snprintf(clock_ampm, 4, "%s", m < 720 ? "am" : "pm");
    } else snprintf(clk, 8, "--:--");
    { int y, mo, d, w; if (local_ymd(&y, &mo, &d, &w)) snprintf(date, 24, "%.3s %d %.3s", DAY_NAMES[w], d, MONTHS[mo - 1]); else date[0] = 0; }
    if (solo && *clock) return 0;
    if (S.show & 2) {
        int ai = -1; int32_t dl = 0; next_alarm(&ai, &dl);
        v[n].icon = ICON_ALARM; v[n].tail[0] = 0;
        if (ai >= 0) { int h, m, on, mask, early; local_alarm_get(ai, &h, &m, &on, &mask, &early); fmt_hm(v[n].val, sizeof v[n].val, h * 60 + m); }
        else snprintf(v[n].val, sizeof v[n].val, "Off");
        n++;
    }
    if (S.show & 4) {
        v[n].icon = S.rain_on ? ICON_CLOUD_RAIN : ICON_PAUSE;
        snprintf(v[n].val, sizeof v[n].val, "%s", S.rain_on ? KINDS[S.rain_kind] : "Paused");
        snprintf(v[n].tail, sizeof v[n].tail, "%d", S.vol);
        n++;
    }
    if (S.show & 8) {
        v[n].icon = S.ac_mode ? ICON_SNOWFLAKE : (S.lights_on ? ICON_LIGHTBULB : ICON_SNOWFLAKE);
        if (S.ac_mode) snprintf(v[n].val, sizeof v[n].val, "%d" DEG, S.sp_x2 / 2); else snprintf(v[n].val, sizeof v[n].val, "Off");
        snprintf(v[n].tail, sizeof v[n].tail, "%s", S.lights_on ? "lights" : "");
        n++;
    }
    return n;
}

static void build_overlay(layer_t *l)
{
    int ox, oy, ow, oh;
    if (!ov_rect(&ox, &oy, &ow, &oh)) { l->on = false; return; }
    layer_reset(l, ox, oy, ow, oh, G_WHITE);
    ov_val_t v[4]; bool clock; char ct[8], ap[4], date[24];
    int n = ov_values(v, &clock, ct, ap, date);
    bool solo = clock && S.night && S.at_night == 1;
    bool links = (S.show & 16) || !net_connected();       /* a lost connection always shows */
    const char *wifi = net_connected() ? ICON_WIFI_HIGH : ICON_WIFI_SLASH;
    int kind = ov_kind();

    if (kind == 0) {                                         /* the strip */
        op_fill(l, 0, oy, W, 4, G_BLACK);
        int cy = oy + 4 + (OV_STRIP_H - 4) / 2, x = MARGIN;
        if (solo) {
            int tw = draw_font_w(F_XL, ct) + (ap[0] ? 12 + draw_font_w(F_M, ap) : 0);
            x = (W - tw) / 2;
        }
        if (clock) {
            op_text(l, x, cy - F_XL->line_h / 2, F_XL, G_BLACK, ct); x += draw_font_w(F_XL, ct);
            if (ap[0]) { x += 12; op_text(l, x, cy - F_M->line_h / 2 + 14, F_M, G_DARK, ap); x += draw_font_w(F_M, ap); }
            x += 96;
        }
        for (int i = 0; i < n; i++) x = ov_item(l, x, cy, v[i].icon, v[i].val, v[i].tail, G_BLACK, G_DARK, F_L) + 96;
        if (links && !solo) {
            int xr = W - MARGIN;
            if (!net_connected()) { xr -= draw_font_w(F_L, "Offline"); op_text(l, xr, cy - F_L->line_h / 2, F_L, G_BLACK, "Offline"); xr -= 18; }
            xr -= draw_font_w(F_IM, wifi); op_text(l, xr, cy - F_IM->line_h / 2, F_IM, G_BLACK, wifi);
            if (ha_connected()) { xr -= 30 + draw_font_w(F_IM, ICON_HOUSE); op_text(l, xr, cy - F_IM->line_h / 2, F_IM, G_BLACK, ICON_HOUSE); }
        }
        return;
    }

    /* cards: a dark clock card, then one light card per item */
    bool left = kind == 1;
    if (left) op_fill(l, OV_LEFT_W - 4, 0, 4, H, G_LIGHT);
    else op_fill(l, 0, oy, W, 4, G_LIGHT);
    int cards = (clock ? 1 : 0) + n + (links && !solo && left ? 1 : 0);
    if (!cards) return;
    int x = OV_PAD, y = oy + OV_PAD;
    int cw = left ? OV_LEFT_W - 2 * OV_PAD : (W - 2 * OV_PAD - (cards - 1) * 26) / cards;
    int ch_clock = left ? 250 : OV_BOTTOM_H - 2 * OV_PAD, ch = left ? 136 : OV_BOTTOM_H - 2 * OV_PAD;
    if (clock) {
        op_rrect(l, x, y, cw, ch_clock, 28, G_BLACK);
        int ty = left ? y + 34 : y + (ch_clock - F_XL->line_h - 10 - F_S->line_h) / 2;
        op_text(l, x + 34, ty, F_XL, G_WHITE, ct);
        if (ap[0]) op_text(l, x + 44 + draw_font_w(F_XL, ct), ty + F_XL->line_h - F_M->line_h - 6, F_M, G_LIGHT, ap);
        if (date[0]) op_text(l, x + 34, ty + F_XL->line_h + 10, F_S, G_LIGHT, date);
        if (left) y += ch_clock + 26; else x += cw + 26;
    }
    for (int i = 0; i < n; i++) {
        op_rrect(l, x, y, cw, ch, 28, CARD_GREY);
        ov_item(l, x + 30, y + ch / 2, v[i].icon, v[i].val, v[i].tail, G_BLACK, G_DARK, F_L);
        if (left) y += ch + 26; else x += cw + 26;
    }
    if (links && !solo && left) {
        int cy = y + 50, xx = x + 30;
        op_text(l, xx, cy - F_IM->line_h / 2, F_IM, G_BLACK, wifi); xx += draw_font_w(F_IM, wifi) + 30;
        if (ha_connected()) op_text(l, xx, cy - F_IM->line_h / 2, F_IM, G_BLACK, ICON_HOUSE);
        if (!net_connected()) op_text(l, x + 30, cy + 40, F_S, G_BLACK, "Offline");
    } else if (links && !solo && !net_connected()) {
        op_text_r(l, W - OV_PAD - 20, oy + 14, F_S, G_BLACK, "Offline");
    }
}

/* ---- confirmations: a box over everything, then the screen as it was ------------
 * A key action or a volume change on the home screen says what it did for
 * 1.5 s; the dashboard underneath is repainted from the frame in PSRAM. */
static char s_toast_txt[24], s_toast_val[44];
static const char *s_toast_icon;

static void toast(const char *icon, const char *txt, const char *val)
{
    s_toast_icon = icon;
    snprintf(s_toast_txt, sizeof s_toast_txt, "%s", txt);
    snprintf(s_toast_val, sizeof s_toast_val, "%s", val ? val : "");
    s_toast_until = (now_ms() + 3000u) | 1u;          /* long enough to read from the pillow */
    rebuild();
    mark(TOAST_X - 32, TOAST_Y - 32, TOAST_W + 64, TOAST_H + 64, IT8951_MODE_GL16);
}

static bool s_toast_loading;
static void toast_loading(const char *title)
{
    toast(ICON_HOUSE, "Loading", title);
    s_toast_loading = true;
    s_toast_until = (now_ms() + 40000u) | 1u;            /* a first render can take a while */
}
/* The update in progress: a card with the percentage; a failure says why. The
 * overnight check: 03:10 local, auto-update on, no alarm within 90 minutes. */
void local_ota_service(void)
{
    static int last_pct = -1; static ota_state_t last = OTA_IDLE;
    ota_state_t st = ota_state();
    if (st == OTA_DOWNLOADING || st == OTA_VERIFYING) {
        int pct = ota_percent();
        if (pct != last_pct || st != last) {
            char v[40]; snprintf(v, sizeof v, "%s  %d%%", ota_target_version(), st == OTA_VERIFYING ? 100 : pct);
            toast(ICON_GEAR, st == OTA_VERIFYING ? "Checking the update" : "Updating", v);
            s_toast_loading = true; s_toast_until = (now_ms() + 120000u) | 1u;
            last_pct = pct;
        }
    } else if (st == OTA_FAILED && last != OTA_FAILED) {
        s_toast_loading = false; toast(ICON_GEAR, "Update failed", ota_error()); last_pct = -1;
    }
    last = st;
    if (!S.auto_update || ota_busy()) return;
    static int done_day = -1;
    int wd, sec; int64_t mn;
    if (!clock_now(&wd, &sec, &mn) || sec / 60 != 3 * 60 + 10 || done_day == (int)(mn / 1440)) return;
    done_day = (int)(mn / 1440);
    int ai; int32_t dl;
    if (next_alarm(&ai, &dl) && dl >= 0 && dl < 90 * 60) { printf("ota: auto-update skipped, an alarm is due\n"); return; }
    ota_auto_update();
}

/* main.c: a new frame arrived, so the loading card goes with the repaint. */
void local_frame_arrived(void)
{
    if (!s_toast_loading) return;
    s_toast_loading = false; s_toast_until = 0; rebuild();
}

static void build_toast(layer_t *l)
{
    /* A rounded card: big icon on the left, the label above, the state large. */
    layer_reset(l, TOAST_X - 32, TOAST_Y - 32, TOAST_W + 64, TOAST_H + 64, G_WHITE);
    op_rrect(l, TOAST_X, TOAST_Y, TOAST_W, TOAST_H, 44, G_BLACK);
    op_rrect(l, TOAST_X + 6, TOAST_Y + 6, TOAST_W - 12, TOAST_H - 12, 38, G_WHITE);
    int cy = TOAST_Y + TOAST_H / 2, x = TOAST_X + 72;
    if (s_toast_icon) {
        op_circle(l, x + 105, cy, 118, CARD_GREY);
        op_text_c(l, x + 105, cy - icon170.line_h / 2, &icon170, G_BLACK, s_toast_icon);
        x += 210 + 64;
    }
    int ty = cy - (F_M->line_h + 8 + F_XL->line_h) / 2;
    op_text(l, x, ty, F_M, G_DARK, s_toast_txt);
    const char *v = s_toast_val[0] ? s_toast_val : s_toast_txt;
    int room = TOAST_X + TOAST_W - 56 - x;
    const bfont_t *vf = draw_font_w(F_XL, v) <= room ? F_XL : draw_font_w(F_L, v) <= room ? F_L : F_M;   /* long titles */
    op_text(l, x, ty + F_M->line_h + 8, vf, G_BLACK, v);
}

/* The strip layer as it was before the last rebuild(), so a change can be
 * marked by what actually differs (the clock's digits) rather than the whole
 * bar: every partial refresh wears the pixels it covers slightly lighter on
 * this panel, so unchanged pixels must not be refreshed again and again. */
static void rebuild(void)
{
    layer_copy(&s_prev_sb, &L_sb);
    L_body.on = L_ring.on = false;
    bool ring = S.phase == PHASE_RINGING;
    build_top(&L_top, ring);
    build_status(&L_sb, ring);
    if (ov_active()) { L_top.on = false; build_overlay(&L_sb); }     /* Mk II home: the dashboard and one overlay */
    if (ring) build_ring(&L_ring);
    else if (s_toast_until) build_toast(&L_ring);
    else if (s_mode == M_HOME && S.dash_page == 0) build_live(&L_body);
    else if (s_mode == M_LIST) build_list(&L_body);
    else if (s_mode == M_CHOICE) build_choice(&L_body);
    else if (s_mode == M_VALUE) build_value(&L_body);
    inputs_set_key_enabled(0x0F);
}

/* Each core has its own scratch line: core 0 renders the web preview from the
 * live layers while core 1 paints the panel from the snapshot. */
static uint8_t s_line[2][W];

void local_overlay_row(int y, uint8_t row[IT8951_ROW_BYTES])
{
    uint8_t *line = s_line[get_core_num()];
    layer_row(&L_body, y, line, row);
    layer_row(&L_top, y, line, row);
    layer_row(&L_sb, y, line, row);
    layer_row(&L_ring, y, line, row);      /* the alarm screen and confirmations: over everything */
}

/* The panel paints from a frozen copy of the layers, so core 0 can rebuild
 * them while core 1 is still streaming the previous state. */
static layer_t P_top, P_body, P_sb, P_ring;

static void layer_copy(layer_t *d, const layer_t *s)
{
    d->n = s->n; d->x = s->x; d->y = s->y; d->w = s->w; d->h = s->h; d->bg = s->bg; d->on = s->on;
    memcpy(d->ops, s->ops, sizeof(op_t) * (size_t)s->n);
}

void local_snapshot(void)
{
    layer_copy(&P_top, &L_top); layer_copy(&P_body, &L_body);
    layer_copy(&P_sb, &L_sb);   layer_copy(&P_ring, &L_ring);
}

void local_snapshot_row(int y, uint8_t row[IT8951_ROW_BYTES])
{
    uint8_t *line = s_line[get_core_num()];
    layer_row(&P_body, y, line, row);
    layer_row(&P_top, y, line, row);
    layer_row(&P_sb, y, line, row);
    layer_row(&P_ring, y, line, row);
}

/* Mark an area outside the local UI's own layout (the banner) for repaint. */
void local_mark_area(int x, int y, int w, int h, uint8_t mode) { mark(x, y, w, h, mode); }

/* ---- repaint regions ---- */
static void mark_screen(void)
{
    s_epoch++;
    s_settle_due = 0;                       /* the list is going away */
    rebuild();
    if (s_mode == M_HOME && S.dash_page > 0) { mark(0, 0, W, H, IT8951_MODE_GC16); return; }   /* overlay layouts differ */
    mark(0, 0, W, SB_Y, IT8951_MODE_GC16);
    /* The strip stays as it is between the home screen and the menus; marking
     * it here merged with the content into a full-screen job, which costs an
     * INIT clear and a flash on every menu open. Its own changes mark it. */
}
/* Quick menus: a knob step paints only the list, in DU (black and white, about
 * a quarter second, no flash); the preview and the greys follow in one GC16
 * pass once the knob has rested for SETTLE_MS. */
#define SETTLE_MS 450u
#define PREVIEW_RECT LIST_W + 3, TB_H + 140, W - LIST_W - 3, 560
static void mark_rows(int a, int b)
{
    rebuild();
    int ya = LIST_Y + a * s_row_h, yb = LIST_Y + b * s_row_h;
    int y0 = ya < yb ? ya : yb, y1 = (ya > yb ? ya : yb) + s_row_h;
    if (S.quick_menus) {
        if (s_settle_queued) { s_dn = 0; s_settle_queued = false; }   /* a turn beat the full-quality pass: drop it, it will come again */
        mark_apart(MARGIN - 8, y0, LIST_W - MARGIN + 8, y1 - y0, IT8951_MODE_DU);   /* the two rows that changed */
        if (S.turn_hints) mark_apart(0, LIST_Y, MARGIN - 8, s_list_n * s_row_h, IT8951_MODE_DU);   /* every row's number moved */
        else mark_apart(0, y0, MARGIN - 8, y1 - y0, IT8951_MODE_DU);
        s_settle_due = now_ms() + SETTLE_MS; s_settle_due |= 1u;
        return;
    }
    mark(0, y0, LIST_W, y1 - y0, IT8951_MODE_GL16);
    mark(PREVIEW_RECT, IT8951_MODE_GL16);
}
bool local_settle_tick(void)
{
    if (!s_settle_due || (int32_t)(now_ms() - s_settle_due) < 0) return false;
    s_settle_due = 0;
    if (s_mode != M_LIST && s_mode != M_CHOICE) return false;
    if (S.settle_full) { mark_full(IT8951_MODE_GC16); s_settle_queued = true; return true; }   /* the whole screen: INIT, then GC16 */
    mark(0, LIST_Y, LIST_W, s_list_n * s_row_h, IT8951_MODE_GC16);
    mark(PREVIEW_RECT, IT8951_MODE_GC16);
    s_settle_queued = true;
    return true;
}
static void mark_value(void)
{
    rebuild();
    mark(MARGIN, TB_H + 60 + icon170.line_h + 20, W - 2 * MARGIN, 720 - icon170.line_h, IT8951_MODE_GL16);
}

static void go_home(void) { s_mode = M_HOME; s_depth = 0; printf("local: home\n"); mark_screen(); }
static void push_node(node_t n)
{
    if (s_mode != M_LIST) s_depth = 0;
    if (s_depth == 0 && n != N_ROOT) { s_stack[0].node = N_ROOT; s_stack[0].sel = 0; s_depth = 1; }
    if (s_depth >= 6) return;
    s_stack[s_depth].node = n; s_stack[s_depth].sel = 0; s_depth++;
    s_mode = M_LIST;
    printf("local: %s\n", node_title(n));
    mark_screen();
}
static void list_back(void)
{
    if (s_depth <= 1) { go_home(); return; }
    s_depth--;
    s_mode = M_LIST;
    printf("local: back to %s\n", node_title(s_stack[s_depth - 1].node));
    mark_screen();
}

void local_init(void) { alarms_load(); sync_alarm_summary(); sound_load(); settings_load(); ext_load(); rebuild(); }
bool local_tick(void) { return false; }

bool local_live_active(void) { return S.dash_page == 0; }

/* The live page: the clock every minute, a tile when its value changes, the
 * header and timeline when the alarms, sleep timer or sound change. */
bool local_live_tick(void)
{
    bool late = false;
    if (s_toast_until && (int32_t)(now_ms() - s_toast_until) >= 0) {        /* the confirmation goes */
        s_toast_until = 0; rebuild();
        mark(TOAST_X - 32, TOAST_Y - 32, TOAST_W + 64, TOAST_H + 64, IT8951_MODE_GL16);
        late = true;
    }
    {   static int64_t ov_min = -1;                                           /* the overlay's clock */
        int owd, osec; int64_t omn = -1;
        if (ov_active() && (S.show & 1) && clock_now(&owd, &osec, &omn) && omn != ov_min) {
            if (ov_min >= 0) { rebuild(); mark_ov(); late = true; }
            ov_min = omn;
        }
    }
    if (late) { bool more = local_live_tick_inner(); return true | more; }
    return local_live_tick_inner();
}

static bool local_live_tick_inner(void)
{
    uint32_t changed = live_service();
    static int64_t last_min = -1;
    static uint32_t last_sig;
    bool vis = S.dash_page == 0 && s_mode == M_HOME && S.phase != PHASE_RINGING;
    int wd = 0, sec = 0; int64_t mn = -1;
    clock_now(&wd, &sec, &mn);
    int left = sleep_left_s();
    int ai = -1; int32_t dl = 0; next_alarm(&ai, &dl);
    int ah = 0, am = 0, aon = 0, amask = 0, ae = 0;
    if (ai >= 0) local_alarm_get(ai, &ah, &am, &aon, &amask, &ae);
    uint32_t sig = (uint32_t)(left > 0 ? (sec + left) / 60 : -1) * 2654435761u ^ (uint32_t)(ai * 7 + ah * 60 + am) * 40503u
                 ^ (uint32_t)ae * 31u ^ (uint32_t)S.rain_on * 977u ^ (uint32_t)S.birds * 13u
                 ^ (uint32_t)(S.ac_mode * 100 + S.sp_x2 + S.fan * 1000 + S.room_x10 * 7) * 2246822519u;
    if (!vis) { last_min = mn; last_sig = sig; return false; }
    bool any = false;
    if (mn != last_min) {
        last_min = mn;
        rebuild();
        mark(0, LV_HEAD_Y, W, LV_HEAD_H, IT8951_MODE_GL16);
        any = true;
    }
    if (sig != last_sig) {
        last_sig = sig;
        rebuild();
        mark(0, LV_HEAD_Y, W, LV_TL_Y + LV_TL_H - LV_HEAD_Y, IT8951_MODE_GL16);
        mark(LV_COL(3), LV_ROW2, LV_COL_W, LV_TILE_H, IT8951_MODE_GL16);
        any = true;
    }
    if (changed) {
        rebuild();
        for (int i = 0; i < LV_COUNT; i++) if (changed & (1u << i)) live_mark_slot(i);
        any = true;
    }
    return any;
}

bool local_open(screen_t s)
{
    s_depth = 0;
    switch (s) {
    case SCR_HOME: go_home(); return true;
    case SCR_MENU: push_node(N_ROOT); return true;
    case SCR_RAIN: push_node(N_RAIN); return true;
    case SCR_LIGHTS: push_node(N_LIGHTS); return true;
    case SCR_AC: push_node(N_AC); return true;
    case SCR_ALARM: push_node(N_ALARMS); return true;
    case SCR_SETTINGS: push_node(N_SETTINGS); return true;
    default: return false;
    }
}

static void volume(int d)
{
    int v = clampi(S.vol + d, 0, 10);
    if (v == S.vol) return;
    S.vol = v;
    publish("config/volume", "%d", S.vol);
    rebuild();
    R_VOL();
    if (s_mode == M_HOME && S.dash_page > 0) { char b[4]; snprintf(b, sizeof b, "%d", S.vol); toast(S.vol ? ICON_SPEAKER_HIGH : ICON_SPEAKER_SLASH, "Volume", b); }
}
/* ---- the alarm clock and the dawn chorus ------------------------------------
 * Runs on the device from the server's clock (Date header + its UTC offset), so
 * the chorus still comes if Home Assistant is down. Before each alarm the wake
 * window (the alarm's "wake up early", else 10 min) builds the chorus from one
 * distant bird to a full one while the sleep sound fades; at the alarm time the
 * panel rings with the chorus at full. Knob press stops; any key or a turn
 * snoozes for 9 min; it gives up after 30 min. A "Once" alarm (no days)
 * switches itself off after it has rung. */
#define SNOOZE_MS     ((uint32_t)S.snooze_min * 60u * 1000u)
#define RING_MAX_MS   (30u * 60u * 1000u)
static uint32_t s_ring_ms, s_snooze_until_ms;
static int      s_ring_alarm = -1;
static int64_t  s_fired_min = -10;

static bool clock_now(int *wday, int *sec, int64_t *minute)
{
    int64_t e = utc_now();
    if (!e) return false;
    alarm_split_time(e + tz_offset_at(e), wday, sec, minute);
    return true;
}

/* The next enabled alarm and the seconds until it; without a clock yet, the
 * first enabled alarm and -1. */
static bool next_alarm(int *idx, int32_t *delta_s)
{
    int wday, sec; int64_t minute;
    *idx = -1; *delta_s = -1;
    if (!clock_now(&wday, &sec, &minute)) {
        for (int i = 0; i < s_nalarms; i++) if (s_alarms[i].on) { *idx = i; return true; }
        return false;
    }
    *idx = alarm_next(s_alarms, s_nalarms, wday * 86400 + sec, false, delta_s);
    return *idx >= 0;
}

static void ring(int i)
{
    s_ring_alarm = i; s_ring_ms = now_ms(); s_snooze_until_ms = 0; s_preview_len_ms = 0;
    if (i >= 0 && i < s_nalarms) { S.alarm_h = s_alarms[i].h; S.alarm_m = s_alarms[i].m; }
    S.phase = PHASE_RINGING; S.rain_on = false; S.lights_on = true;
    publish("event", "alarm_ringing");
    s_mode = M_HOME; s_depth = 0; mark_screen();
}

static void snooze(void)
{
    S.phase = PHASE_IDLE; s_snooze_until_ms = now_ms() + SNOOZE_MS;
    publish("event", "alarm_snoozed %d min", S.snooze_min); go_home();
}

static void stop_alarm(void)
{
    S.phase = PHASE_IDLE; s_snooze_until_ms = 0;
    int i = s_ring_alarm; s_ring_alarm = -1;
    if (i >= 0 && i < s_nalarms) {
        if (alarm_is_once(&s_alarms[i])) { s_alarms[i].on = false; alarms_save(); sync_alarm_summary(); }
    }
    publish("event", "alarm_stopped"); go_home();
}

static void chorus_preview(int seconds)
{
    if (seconds <= 0) { s_preview_len_ms = 0; publish("event", "chorus_preview_stop"); return; }
    s_preview_start_ms = now_ms(); s_preview_len_ms = (uint32_t)seconds * 1000u;
    publish("event", "chorus_preview %d s", seconds);
}

void local_alarm_tick(bool *changed)
{
    uint32_t t = now_ms();
    {   /* auto night: switch at the window's edges only, so a manual change holds until the next one */
        static int last_in = -1;
        int wd, sc; int64_t mn;
        if (S.auto_night && clock_now(&wd, &sc, &mn)) {
            int in = alarm_auto_night_in(S.auto_night, sc / 60) ? 1 : 0;
            if (in != last_in) {
                last_in = in;
                if ((bool)in != S.night) {
                    S.night = in; inputs_set_night(S.night); config_set_lights(inputs_backlight(), S.night); config_save();
                    publish("config/night", S.night ? "on" : "off");
                    rebuild(); R_SBMID(); if (changed) *changed = true;
                }
            }
        } else last_in = -1;
    }
    float c = 0;
    if (s_preview_len_ms) {                         /* preview: build, then 20 s at full */
        uint32_t el = t - s_preview_start_ms;
        if (el < s_preview_len_ms) c = 0.05f + 0.95f * (float)el / (float)s_preview_len_ms;
        else if (el < s_preview_len_ms + 20000u) c = 1.0f;
        else { s_preview_len_ms = 0; if (changed) *changed = true; rebuild(); }
    }
    if (S.phase == PHASE_RINGING) {
        c = 1.0f;
        if (t - s_ring_ms > RING_MAX_MS) { stop_alarm(); if (changed) *changed = true; }
        S.chorus = c; return;
    }
    if (s_snooze_until_ms) {
        if ((int32_t)(t - s_snooze_until_ms) >= 0) { ring(s_ring_alarm); if (changed) *changed = true; S.chorus = 1.0f; return; }
        S.chorus = c; return;
    }
    int wday, sec; int64_t minute;
    if (!clock_now(&wday, &sec, &minute)) { S.chorus = c; return; }
    int32_t best_delta;
    int best = alarm_next(s_alarms, s_nalarms, wday * 86400 + sec, true, &best_delta);
    if (best >= 0 && best_delta <= 0 && minute - s_fired_min > 1) {
        s_fired_min = minute;
        ring(best); if (changed) *changed = true; S.chorus = 1.0f; return;
    }
    if (best >= 0 && best_delta > 0) {
        int win = alarm_window_s(&s_alarms[best]);
        if (best_delta <= win) {
            float w = alarm_chorus_level(best_delta, win);
            if (w > c) c = w;
            if (S.phase == PHASE_IDLE) {
                S.phase = PHASE_PREWAKE; S.lights_on = true; S.bright = 30;
                publish("event", "prewake %02d:%02d", s_alarms[best].h, s_alarms[best].m);
                rebuild(); if (s_mode == M_HOME) R_SBMID(); if (changed) *changed = true;
            }
            S.chorus = c; return;
        }
    }
    if (S.phase == PHASE_PREWAKE) S.phase = PHASE_IDLE;   /* the alarm was moved or switched off */
    S.chorus = c;
}

/* Speed: detents arriving close together count for more. A slow click moves
 * one step; a quick flick takes steps of 3x / 6x. Values only: in lists and
 * choices every detent is exactly one row. */
static uint32_t s_last_turn_ms;
static int accel_for(int d)
{
    uint32_t now = now_ms(), dt = now - s_last_turn_ms;
    s_last_turn_ms = now;
    int ad = d < 0 ? -d : d;
    if (ad >= 4 || dt < 60)  return 6;
    if (ad >= 2 || dt < 140) return 3;
    return 1;
}

/* Knob turn; d is the signed number of detents since the last call. */
bool local_turn(int d)
{
    if (!d) return true;
    if (S.phase == PHASE_RINGING) { snooze(); return true; }
    int acc = accel_for(d);
    switch (s_mode) {
    case M_HOME: volume(d > 0 ? 1 : -1); return true;
    case M_LIST: {
        int *sel = &s_stack[s_depth - 1].sel, n = node_rows(s_stack[s_depth - 1].node, s_rows), old = *sel;
        *sel = clampi(*sel + d, 0, n - 1);          /* one detent, one row: no speed-up in lists */
        if (*sel != old) mark_rows(old, *sel);
        return true; }
    case M_CHOICE: {
        const char *const *o; int n = choice_opts(s_edit, &o) + 1, old = s_csel;
        s_csel = clampi(s_csel + d, 0, n - 1);
        if (s_csel != old) mark_rows(old, s_csel);
        return true; }
    case M_VALUE: value_step(s_edit, d, acc); mark_value(); return true;
    }
    return true;
}

/* The centre button: choose. */
bool local_press(void)
{
    if (S.phase == PHASE_RINGING) { stop_alarm(); return true; }
    switch (s_mode) {
    case M_HOME: push_node(N_ROOT); return true;
    case M_VALUE:
        if (s_edit == V_ALARM_TIME) publish_alarm(s_ai);
        s_mode = M_LIST; mark_screen(); return true;
    case M_CHOICE: {
        const char *const *o; int n = choice_opts(s_edit, &o);
        if (s_csel < n) choice_set(s_edit, s_csel);
        s_mode = M_LIST; mark_screen(); return true; }
    case M_LIST: {
        int n = node_rows(s_stack[s_depth - 1].node, s_rows), sel = s_stack[s_depth - 1].sel;
        if (sel >= n) return true;
        row_def_t r = s_rows[sel];
        switch (r.kind) {
        case K_TOGGLE: toggle_flip(&r); mark_rows(sel, sel); return true;
        case K_SUB:    if (r.id == S_ALARM_ITEM) s_ai = r.arg; if (r.id == S_KEY) s_ki = r.arg; push_node(sub_node(r.id)); return true;
        case K_VALUE:  if ((r.id == V_TIME || r.id == V_DATE) && S.auto_time) return true;
                       s_edit = r.id; snprintf(s_edit_label, sizeof s_edit_label, "%s", r.label); s_mode = M_VALUE; mark_screen(); return true;
        case K_CHOICE: if (r.id == C_DASH) tesserae_picks_fetch();     /* fresh: dashboards can be bound any time */
                       s_edit = r.id; snprintf(s_edit_label, sizeof s_edit_label, "%s", r.label); s_csel = clampi(choice_get(r.id), 0, 99); s_mode = M_CHOICE; mark_screen(); return true;
        case K_BACK:   list_back(); return true;
        case K_ACTION:
            if (r.id == A_ADD_ALARM && s_nalarms < MAX_ALARMS) {
                s_alarms[s_nalarms] = (alarm_t){ 7, 0, true, {1,1,1,1,1,0,0}, 15 };
                s_ai = s_nalarms++; publish_alarm(s_ai); sync_alarm_summary();
                s_stack[s_depth - 1].sel = s_ai;
                push_node(N_ALARM);
            } else if (r.id == A_REFRESH) {
                s_req = LREQ_REFRESH;
            } else if (r.id == A_RESTART) {
                s_req = LREQ_RESTART;
            } else if (r.id == A_WIFISETUP) {
                s_req = LREQ_SETUP;
            } else if (r.id == A_OTACHECK) {
                ota_releases_fetch(); s_rel_armed = -1; mark_screen();
            } else if (r.id == A_RELEASE) {
                if (s_rel_armed != r.arg) { s_rel_armed = r.arg; int sl = s_stack[s_depth - 1].sel; mark_rows(sl, sl); }
                else { s_rel_armed = -1; if (!ota_install(r.arg)) toast(ICON_GEAR, "Update failed", ota_error()); }
            } else if (r.id == A_PREVIEW) {
                chorus_preview(s_preview_len_ms ? 0 : 90);
                rebuild(); { int sl = s_stack[s_depth - 1].sel; mark_rows(sl, sl); }
            } else if (r.id == A_DELETE_ALARM) {
                publish("set/alarm", "%d delete", r.arg + 1);
                for (int i = r.arg; i < s_nalarms - 1; i++) s_alarms[i] = s_alarms[i + 1];
                s_nalarms--; s_ai = 0; alarms_save(); sync_alarm_summary();
                list_back();
            }
            return true;
        case K_INFO: return true;
        }
    } }
    return true;
}

/* MENU (and knob hold): back one level. */
bool local_back(void)
{
    if (S.phase == PHASE_RINGING) { snooze(); return true; }
    switch (s_mode) {
    case M_HOME: push_node(N_ROOT); return true;
    case M_VALUE: if (s_edit == V_ALARM_TIME) publish_alarm(s_ai); s_mode = M_LIST; mark_screen(); return true;
    case M_CHOICE: s_mode = M_LIST; mark_screen(); return true;
    case M_LIST: list_back(); return true;
    }
    return true;
}

static void state_changed(void)
{
    rebuild();
    if (s_mode == M_HOME) R_SBMID();
    else if (s_mode == M_LIST) { int s = s_stack[s_depth - 1].sel; mark_rows(s, s); }
}

static void dash_step(int d)
{
    dash_go((S.dash_page + d + 3) % 3);
    if (s_mode != M_HOME) go_home(); else rebuild();
}

/* Keys 1-3 wait to tell a press from a hold only when they have a hold
 * action; MENU always does (hold: home). */
bool local_key_has_hold(int i)
{
    if (S.phase == PHASE_RINGING || i < 0 || i > 3) return false;
    if (i == 3) return true;
    const char *b = config_get()->bind[CONFIG_BIND_KEY1_HOLD + i];
    return b[0] && strcmp(b, "none") != 0;
}

/* True when the UI handled the key itself: the alarm ringing, or MENU. Keys
 * 1-3 otherwise run their press / hold bindings (main.c). */
bool local_key(int i, bool hold)
{
    if (i < 0 || i > 3) return false;
    if (S.phase == PHASE_RINGING) { snooze(); return true; }
    if (i == 3) { if (hold) { if (s_mode != M_HOME) go_home(); return true; } return local_back(); }
    return false;
}

bool local_back_up(void)
{
    if (S.phase == PHASE_RINGING) { snooze(); return true; }
    if (s_mode == M_HOME) return false;
    return local_back();
}

bool local_action(const char *id)
{
    if (!id) return false;
    if (!strcmp(id, "menu"))          { if (s_mode == M_HOME) push_node(N_ROOT); else go_home(); return true; }
    if (!strcmp(id, "menu_select"))   return local_press();
    if (!strcmp(id, "back"))          return local_back();
    if (!strcmp(id, "vol.up"))        { volume(+1); return true; }
    if (!strcmp(id, "vol.down"))      { volume(-1); return true; }
    if (!strcmp(id, "rain.toggle"))   { toggle_flip(&R_T_RAIN); state_changed(); toast(ICON_CLOUD_RAIN, KINDS[S.rain_kind], S.rain_on ? "On" : "Off"); return true; }
    if (!strcmp(id, "lights.toggle")) { toggle_flip(&R_T_LIGHTS); state_changed(); toast(ICON_LIGHTBULB, "Lights", S.lights_on ? "On" : "Off"); return true; }
    if (!strcmp(id, "ac.toggle"))     { toggle_flip(&R_T_AC); state_changed();
                                        char v[16]; if (S.ac_mode) snprintf(v, sizeof v, "%s %d" DEG, AC_MODES[S.ac_mode], S.sp_x2 / 2); else snprintf(v, sizeof v, "Off");
                                        toast(ICON_SNOWFLAKE, "AC", v); return true; }
    if (!strcmp(id, "alarm.toggle"))  { if (s_nalarms) { s_alarms[0].on = !s_alarms[0].on; publish_alarm(0); sync_alarm_summary(); } state_changed();
                                        char v[8]; if (S.alarm_on) alarm_txt(v, sizeof v); else snprintf(v, sizeof v, "Off");
                                        toast(ICON_ALARM, "Alarm", v); return true; }
    if (!strcmp(id, "night"))         { toggle_flip(&R_T_NIGHT); state_changed(); toast(ICON_MOON, "Night mode", S.night ? "On" : "Off"); return true; }
    if (!strcmp(id, "light.night"))   { S.lights_on = true; S.light_mode = 1; S.bright = 10; publish("set/lights", "night 10%%"); state_changed(); toast(ICON_LIGHTBULB, "Night light", "10%"); return true; }
    if (!strcmp(id, "dash.next"))     { dash_step(+1); return true; }
    if (!strcmp(id, "dash.prev"))     { dash_step(-1); return true; }
    if (!strncmp(id, "open.", 5)) {
        const char *n = id + 5;
        node_t nd = !strcmp(n, "ac") ? N_AC : !strcmp(n, "lights") ? N_LIGHTS : !strcmp(n, "sound") || !strcmp(n, "rain") ? N_RAIN :
                    !strcmp(n, "alarm") ? N_ALARMS : !strcmp(n, "settings") || !strcmp(n, "status") || !strcmp(n, "keys") ? N_SETTINGS :
                    !strcmp(n, "menu") ? N_ROOT : N_COUNT;
        if (nd == N_COUNT) return false;
        s_depth = 0; push_node(nd); return true;
    }
    return false;
}

bool local_scenario(const char *name)
{
    if (!strcmp(name, "ring"))    { sync_alarm_summary(); ring(-1); return true; }
    if (!strcmp(name, "prewake")) { S.phase = PHASE_PREWAKE; S.rain_on = false; S.lights_on = true; S.bright = 30; publish("event", "prewake"); state_changed(); return true; }
    if (!strcmp(name, "stop"))    { if (S.phase == PHASE_RINGING) stop_alarm(); else { S.phase = PHASE_IDLE; s_snooze_until_ms = 0; go_home(); } return true; }
    if (!strcmp(name, "power"))   { S.on_battery = true; publish("state/power", "battery %d%%", S.batt_pct); state_changed(); return true; }
    if (!strcmp(name, "mains"))   { S.on_battery = false; publish("state/power", "mains"); state_changed(); return true; }
    return false;
}

/* ---- direct control (the phone web app) -------------------------------------- */
static void refresh_after_set(void)
{
    rebuild();
    if (s_mode == M_HOME) R_SBMID();
    else mark(0, TB_H, W, SB_Y - TB_H, IT8951_MODE_GL16);
}

/* set=<key>|<value>. Returns false for an unknown key or a bad value. */
bool local_set(const char *key, const char *val)
{
    int v = atoi(val);
    if (!strcmp(key, "vol"))            { if (v < 0 || v > 10) return false; S.vol = v; publish("config/volume", "%d", v); rebuild(); R_VOL(); return true; }
    else if (!strcmp(key, "rain_on"))   { S.rain_on = v != 0; publish("set/rain", S.rain_on ? "play" : "pause"); }
    else if (!strcmp(key, "rain_lvl"))  { if (v < 1 || v > 5) return false; S.rain_lvl = v; publish("set/rain", "level %d", v); }
    else if (!strcmp(key, "rain_kind")) { if (v < 0 || v > 4) return false; S.rain_kind = v; publish("set/rain", "%s", KINDS[v]); }
    else if (!strcmp(key, "sleep"))     { if (v != 0 && v != 15 && v != 30 && v != 60) return false; S.sleep_min = v; publish("set/rain", "sleep %d", v); }
    else if (!strcmp(key, "lights_on")) { S.lights_on = v != 0; publish("set/lights", S.lights_on ? "on %d%%" : "off", S.bright); }
    else if (!strcmp(key, "bright"))    { if (v < 5 || v > 100) return false; S.bright = v; S.lights_on = true; publish("set/lights", "on %d%%", v); }
    else if (!strcmp(key, "colour"))    { if (v < 0 || v > 1) return false; S.light_mode = v; publish("set/lights", "%s", v ? "night" : "warm"); }
    else if (!strcmp(key, "ac_mode"))   { if (v < 0 || v > 4) return false; S.ac_mode = v; publish("set/ac", "%s", AC_MODES[v]); }
    else if (!strcmp(key, "setpoint"))  { int x2 = (int)(atof(val) * 2 + 0.5); if (x2 < 32 || x2 > 60) return false; S.sp_x2 = x2; if (!S.ac_mode) S.ac_mode = 3; publish("set/ac", "%s", val); }
    else if (!strcmp(key, "fan"))       { if (v < 0 || v > 3) return false; S.fan = v; publish("set/ac", "fan %s", FANS[v]); }
    else if (!strcmp(key, "night"))     { if ((v != 0) != S.night) toggle_flip(&R_T_NIGHT); }
    else if (!strcmp(key, "keylights")) { if (v < 0 || v > 100) return false; uint8_t lv = (uint8_t)(v * 255 / 100); inputs_set_backlight(lv); config_set_lights(lv, S.night); config_save(); return true; }
    else if (!strcmp(key, "dash"))      { if (v < 0 || v > 2) return false; dash_go(v); if (s_mode == M_HOME) mark_screen(); }
    else if (!strcmp(key, "pick"))      { if (v < -1 || v >= tesserae_pick_count()) return false; if (v < 0) { dash_go(0); s_dash_sel = 0; } else dash_pick(v + 1); }
    else if (!strcmp(key, "patter") || !strcmp(key, "wash") || !strcmp(key, "tone") || !strcmp(key, "wind") ||
             !strcmp(key, "thunder") || !strcmp(key, "thunder_near")) {
        if (v < 0 || v > 100) return false;
        int *f = !strcmp(key, "patter") ? &S.patter : !strcmp(key, "wash") ? &S.wash : !strcmp(key, "tone") ? &S.tone :
                 !strcmp(key, "wind") ? &S.wind : !strcmp(key, "thunder") ? &S.thunder : &S.thunder_near;
        *f = v; publish("set/sound", "%s %d", key, v);
    }
    else if (!strcmp(key, "surface"))   { if (v < 0 || v > 3) return false; S.surface = v; publish("set/rain", "surface %s", SURFACES[v]); }
    else if (!strcmp(key, "strike"))    { S.strike++; publish("event", "thunder"); return true; }
    else if (!strcmp(key, "key_col") || !strcmp(key, "menu_col") || !strcmp(key, "night_col")) {
        if (v < 0 || v >= N_PAL) return false;
        *(!strcmp(key, "key_col") ? &S.key_col : !strcmp(key, "menu_col") ? &S.menu_col : &S.night_col) = v;
        apply_colours(); return true;
    }
    else if (!strcmp(key, "knob_light")) { S.knob_light = v != 0; apply_colours(); return true; }
    else if (!strcmp(key, "auto_night")) { if (v < 0 || v > 3) return false; S.auto_night = v; return true; }
    else if (!strcmp(key, "clock12"))    { S.clock12 = v != 0; rebuild(); if (s_mode == M_HOME && S.dash_page == 0) mark(0, LV_HEAD_Y, W, LV_HEAD_H, IT8951_MODE_GL16); return true; }
    else if (!strcmp(key, "snooze"))     { if (v < 1 || v > 30) return false; S.snooze_min = v; return true; }
    else if (!strcmp(key, "night_keys")) { if (v < 0 || v > 1) return false; S.night_keys = v; apply_colours(); return true; }
    else if (!strcmp(key, "overlay"))    { if (v < 0 || v > 3) return false; S.overlay = v; overlay_apply(); if (s_mode == M_HOME) mark_screen(); return true; }
    else if (!strcmp(key, "show"))       { if (v < 0 || v > 31) return false; S.show = v; overlay_apply(); if (s_mode == M_HOME) mark_screen(); return true; }
    else if (!strcmp(key, "at_night"))   { if (v < 0 || v > 1) return false; S.at_night = v; rebuild(); if (ov_active()) mark_ov(); return true; }
    else if (!strcmp(key, "tz"))         { if (v < 0 || v >= N_TZ) return false; S.tz = v; rebuild(); if (ov_active()) mark_ov(); return true; }
    else if (!strcmp(key, "autoupdate"))   { S.auto_update = v != 0; return true; }
    else if (!strcmp(key, "speaker"))      { S.speaker = v != 0; publish("config/speaker", S.speaker ? "on" : "off"); return true; }
    else if (!strcmp(key, "power_mon"))    { S.power_mon = v != 0; if (!S.power_mon && S.on_battery) { S.on_battery = false; state_changed(); } return true; }
    else if (!strcmp(key, "rec"))          { if (strlen(val) >= sizeof S.rec) return false; snprintf(S.rec, sizeof S.rec, "%s", val); }
    else if (!strcmp(key, "refresh_mode")) { if (v < 0 || v > 2) return false; S.refresh_mode = v; s_req = LREQ_REFRESH; return true; }
    else if (!strcmp(key, "turn_hints"))   { S.turn_hints = v != 0; if (s_mode == M_LIST || s_mode == M_CHOICE) mark_screen(); return true; }
    else if (!strcmp(key, "quick_menus"))  { S.quick_menus = v != 0; return true; }
    else if (!strcmp(key, "settle_full"))  { S.settle_full = v != 0; return true; }
    else if (!strcmp(key, "wf_temp"))      { if (v < 0 || v > 50) return false; S.wf_temp = v; s_req = LREQ_REFRESH; return true; }
    else if (!strcmp(key, "auto_time"))  { S.auto_time = v != 0; if (!S.auto_time) manual_start(); rebuild(); return true; }
    else if (!strcmp(key, "birds"))     { if (v < 0 || v > BIRDS_ALL) return false; S.birds = (uint16_t)v; }
    else if (!strcmp(key, "bird_vol"))  { if (v < 1 || v > 10) return false; S.bird_vol = v; return true; }
    else if (!strcmp(key, "audition"))  { if (v < 0 || v >= BIRD_COUNT) return false; S.audition_bird = v; S.audition++; return true; }
    else if (!strcmp(key, "chorus_preview")) { if (v < 0 || v > 900) return false; chorus_preview(v); }
    else if (!strcmp(key, "alarm_stop"))  { if (S.phase == PHASE_RINGING) stop_alarm(); else if (s_snooze_until_ms) { s_snooze_until_ms = 0; s_ring_alarm = -1; } else return false; }
    else if (!strcmp(key, "alarm_snooze")) { if (S.phase != PHASE_RINGING) return false; snooze(); }
    else if (!strcmp(key, "alarm")) {
        /* i,h,m,on,daysmask,early */
        int i, h, m, on, mask, early;
        if (sscanf(val, "%d,%d,%d,%d,%d,%d", &i, &h, &m, &on, &mask, &early) != 6) return false;
        if (i < 0 || i >= s_nalarms || h < 0 || h > 23 || m < 0 || m > 59 || mask < 0 || mask > 127 || early < 0 || early > 60) return false;
        s_alarms[i].h = h; s_alarms[i].m = m; s_alarms[i].on = on != 0; s_alarms[i].early = early;
        for (int d = 0; d < 7; d++) s_alarms[i].days[d] = (mask >> d) & 1;
        publish_alarm(i); sync_alarm_summary();
    }
    else if (!strcmp(key, "alarm_add")) {
        if (s_nalarms >= MAX_ALARMS) return false;
        s_alarms[s_nalarms] = (alarm_t){ 7, 0, true, {1,1,1,1,1,0,0}, 15 };
        publish_alarm(s_nalarms++); sync_alarm_summary();
    }
    else if (!strcmp(key, "alarm_del")) {
        if (v < 0 || v >= s_nalarms) return false;
        publish("set/alarm", "%d delete", v + 1);
        for (int i = v; i < s_nalarms - 1; i++) s_alarms[i] = s_alarms[i + 1];
        s_nalarms--; if (s_ai >= s_nalarms) s_ai = 0;
        alarms_save(); sync_alarm_summary();
        if (s_mode != M_HOME && local_screen() == SCR_ALARM) { s_depth = 0; go_home(); return true; }
    }
    else return false;
    refresh_after_set();
    return true;
}

/* ---- read-only views for ha.c ---- */
int  local_alarm_count(void) { return s_nalarms; }
bool local_alarm_get(int i, int *h, int *m, int *on, int *mask, int *early)
{
    if (i < 0 || i >= s_nalarms) return false;
    *h = s_alarms[i].h; *m = s_alarms[i].m; *on = s_alarms[i].on; *early = s_alarms[i].early;
    *mask = 0; for (int d = 0; d < 7; d++) if (s_alarms[i].days[d]) *mask |= 1 << d;
    return true;
}
const char *local_dash_name(int i) { return (i >= 0 && i < 3) ? DASHES[i] : ""; }
int  local_dash_count(void) { return 3; }

/* ---- sound settings persistence (flash blob slot 1) ---- */
#define SND_MAGIC 0x534E4433u   /* "SND3" */
typedef struct {
    int8_t vol, rain_kind, rain_lvl, surface;
    uint8_t patter, wash, tone, wind, thunder, thunder_near, bird_vol, pad;
    uint16_t birds;
} snd_blob_t;
static void snd_pack(snd_blob_t *b)
{
    memset(b, 0, sizeof *b);
    b->vol = (int8_t)S.vol; b->rain_kind = (int8_t)S.rain_kind; b->rain_lvl = (int8_t)S.rain_lvl; b->surface = (int8_t)S.surface;
    b->patter = (uint8_t)S.patter; b->wash = (uint8_t)S.wash; b->tone = (uint8_t)S.tone; b->wind = (uint8_t)S.wind;
    b->thunder = (uint8_t)S.thunder; b->thunder_near = (uint8_t)S.thunder_near;
    b->bird_vol = (uint8_t)S.bird_vol; b->birds = S.birds;
    b->pad = 1;                         /* 1: saved after the synthesised birds were added */
}
static snd_blob_t s_snd_saved;
static uint32_t   s_snd_changed_at;
static void sound_load(void)
{
    snd_blob_t b;
    if (!config_blob_load(1, SND_MAGIC, &b, sizeof b)) { snd_pack(&s_snd_saved); return; }
    S.vol = clampi(b.vol, 0, 10); S.rain_kind = clampi(b.rain_kind, 0, 4); S.rain_lvl = clampi(b.rain_lvl, 1, 5); S.surface = clampi(b.surface, 0, 3);
    S.bird_vol = clampi(b.bird_vol, 1, 10); S.birds = b.birds & BIRDS_ALL;
    if (b.pad != 1) S.birds |= BIRDS_SYNTH;      /* settings from before: switch the new birds on once */
    S.patter = b.patter; S.wash = b.wash; S.tone = b.tone; S.wind = b.wind; S.thunder = b.thunder; S.thunder_near = b.thunder_near;
    s_snd_saved = b;
    printf("local: sound settings loaded\n");
}
/* Panel settings (blob slot 4). */
#define SET_MAGIC  0x53455431u  /* "SET1" (read once, to migrate) */
#define SET2_MAGIC 0x53455432u  /* "SET2" */
typedef struct { uint8_t key_col, menu_col, night_col, knob, auto_night, clock12, snooze, pad; } set1_blob_t;
typedef struct { uint8_t key_col, menu_col, night_col, knob, auto_night, clock12, snooze,
                 night_keys, overlay, show, at_night, tz, auto_time, refresh_mode, auto_update, pad[1]; } set_blob_t;
static set_blob_t s_set_saved;
static uint32_t   s_set_changed_at;
static void set_pack(set_blob_t *b)
{
    memset(b, 0, sizeof *b);
    b->key_col = (uint8_t)S.key_col; b->menu_col = (uint8_t)S.menu_col; b->night_col = (uint8_t)S.night_col;
    b->knob = S.knob_light; b->auto_night = (uint8_t)S.auto_night; b->clock12 = S.clock12; b->snooze = (uint8_t)S.snooze_min;
    b->night_keys = (uint8_t)S.night_keys; b->overlay = (uint8_t)S.overlay; b->show = (uint8_t)S.show; b->at_night = (uint8_t)S.at_night;
    b->tz = (uint8_t)S.tz; b->auto_time = S.auto_time; b->refresh_mode = (uint8_t)S.refresh_mode; b->auto_update = S.auto_update;
    b->pad[0] = (uint8_t)S.wf_temp;
}
static void settings_load(void)
{
    set_blob_t b; set1_blob_t o;
    if (config_blob_load(4, SET2_MAGIC, &b, sizeof b)) {
        S.night_keys = b.night_keys % 2; S.overlay = b.overlay % 4; S.show = b.show & 0x1F; S.at_night = b.at_night % 2;
        S.tz = b.tz % N_TZ; S.auto_time = b.auto_time; S.refresh_mode = b.refresh_mode % 3; S.auto_update = b.auto_update == 1;
        S.wf_temp = b.pad[0] <= 50 ? b.pad[0] : 0;
    } else if (config_blob_load(4, SET_MAGIC, &o, sizeof o)) {
        memset(&b, 0, sizeof b); memcpy(&b, &o, 7);           /* the SET1 fields; Mk II ones stay at their defaults */
    } else b.snooze = 0, b.knob = 2;
    if (b.knob != 2) {
        S.key_col = b.key_col % N_PAL; S.menu_col = b.menu_col % N_PAL; S.night_col = b.night_col % N_PAL;
        S.knob_light = b.knob; S.auto_night = b.auto_night % 4; S.clock12 = b.clock12;
        S.snooze_min = (b.snooze >= 1 && b.snooze <= 30) ? b.snooze : 9;
    }
    set_pack(&s_set_saved);
    apply_colours();
    overlay_apply();
}

/* Hardware settings and the recording (blob slot 5). */
#define EXT_MAGIC 0x31545845u   /* "EXT1" */
typedef struct { uint8_t speaker, power_mon, rsv0, pad; char rsv1[48], rec[40]; } ext_blob_t;   /* rsv0: menu flags; rsv1: the gesture settings, removed (kept so saved settings still load) */
static ext_blob_t s_ext_saved;
static uint32_t   s_ext_changed_at;
static void ext_pack(ext_blob_t *b)
{
    memset(b, 0, sizeof *b);
    b->speaker = S.speaker; b->power_mon = S.power_mon;
    b->rsv0 = (uint8_t)((S.turn_hints ? 0 : 1) | (S.quick_menus ? 0 : 2) | (S.settle_full ? 4 : 0));   /* bits 0-1 set = off (older blobs read as on); bit 2 set = on */
    memcpy(b->rec, S.rec, sizeof b->rec);
}
static void ext_load(void)
{
    ext_blob_t b;
    if (config_blob_load(5, EXT_MAGIC, &b, sizeof b)) {
        S.speaker = b.speaker; S.power_mon = b.power_mon;
        S.turn_hints = !(b.rsv0 & 1); S.quick_menus = !(b.rsv0 & 2); S.settle_full = (b.rsv0 & 4) != 0;
        b.rec[39] = 0; memcpy(S.rec, b.rec, sizeof S.rec);
    }
    ext_pack(&s_ext_saved);
}

void local_power(bool on_battery, int pct, bool low)
{
    bool was = S.on_battery;
    int before = S.batt_pct;
    S.on_battery = on_battery; S.batt_pct = pct;
    if (on_battery != was) {
        publish("state/power", on_battery ? "battery %d%%" : "mains", pct);
        if (on_battery) toast(ICON_BATTERY_CHARGING, "On battery", "");
        else            toast(ICON_PLUG, "Mains power", "");
        state_changed();
    } else if (on_battery && pct != before) {
        publish("state/power", "battery %d%%", pct);
        if (low && before >= 15 && pct < 15) toast(ICON_BATTERY_CHARGING, "Battery low", "");
        state_changed();
    }
}

void local_persist_tick(void)
{
    {   ext_blob_t now; ext_pack(&now);
        if (memcmp(&now, &s_ext_saved, sizeof now)) {
            uint32_t t = now_ms();
            if (!s_ext_changed_at) s_ext_changed_at = t;
            else if (t - s_ext_changed_at >= 3000) {
                s_ext_changed_at = 0;
                if (config_blob_save(5, EXT_MAGIC, &now, sizeof now)) { s_ext_saved = now; printf("local: hardware settings saved\n"); }
            }
        } else s_ext_changed_at = 0;
    }
    {   set_blob_t now; set_pack(&now);
        if (memcmp(&now, &s_set_saved, sizeof now)) {
            uint32_t t = now_ms();
            if (!s_set_changed_at) s_set_changed_at = t;
            else if (t - s_set_changed_at >= 3000) {
                s_set_changed_at = 0;
                if (config_blob_save(4, SET2_MAGIC, &now, sizeof now)) { s_set_saved = now; printf("local: settings saved\n"); }
            }
        } else s_set_changed_at = 0;
    }
    snd_blob_t now; snd_pack(&now);
    if (!memcmp(&now, &s_snd_saved, sizeof now)) { s_snd_changed_at = 0; return; }
    uint32_t t = now_ms();
    if (!s_snd_changed_at) { s_snd_changed_at = t; return; }
    if (t - s_snd_changed_at < 4000) return;               /* wait until the knob stops */
    s_snd_changed_at = 0;
    if (config_blob_save(1, SND_MAGIC, &now, sizeof now)) { s_snd_saved = now; printf("local: sound settings saved\n"); }
}

/* Sleep timer: armed when sleep sounds turn on (or the timer is changed while
 * they play); fades the sound over the last minute, then turns it off. */
static uint32_t s_sleep_end;
static bool     s_prev_rain_on;
static int      s_prev_sleep = -1;

float local_sleep_tick(bool *changed)
{
    uint32_t t = now_ms();
    if (S.rain_on != s_prev_rain_on || S.sleep_min != s_prev_sleep) {
        s_sleep_end = (S.rain_on && S.sleep_min) ? t + (uint32_t)S.sleep_min * 60000u : 0;
        s_prev_rain_on = S.rain_on; s_prev_sleep = S.sleep_min;
    }
    if (!s_sleep_end) return 1.0f;
    int32_t left = (int32_t)(s_sleep_end - t);
    if (left <= 0) {
        printf("local: sleep timer ended\n");
        s_sleep_end = 0;
        local_set("rain_on", "0");
        s_prev_rain_on = false;
        if (changed) *changed = true;
        return 0.0f;
    }
    return left < 60000 ? (float)left / 60000.0f : 1.0f;
}

static int sleep_left_s(void) { return s_sleep_end ? (int)((int32_t)(s_sleep_end - now_ms()) / 1000) : 0; }

/* The device-side state for the web app, as a JSON object (no braces around
 * the whole: the caller embeds it). Returns bytes written. */
size_t local_state_json(char *b, size_t cap)
{
    size_t n = 0;
#define J(...) do { int k = snprintf(b + n, cap > n ? cap - n : 0, __VA_ARGS__); if (k > 0) n += (size_t)k; } while (0)
    J("{\"vol\":%d,\"rain\":{\"on\":%d,\"lvl\":%d,\"kind\":%d,\"sleep\":%d,\"sleep_left_s\":%d},", S.vol, S.rain_on, S.rain_lvl, S.rain_kind, S.sleep_min, sleep_left_s() > 0 ? sleep_left_s() : 0);
    {
        int left = s_preview_len_ms ? (int)((int32_t)(s_preview_start_ms + s_preview_len_ms + 20000u - now_ms()) / 1000) : 0;
        int snz = s_snooze_until_ms ? (int)((int32_t)(s_snooze_until_ms - now_ms()) / 1000) : 0;
        J("\"chorus\":{\"birds\":%u,\"vol\":%d,\"level\":%d,\"preview_s\":%d,\"snooze_s\":%d,\"names\":[", S.birds, S.bird_vol, (int)(S.chorus * 100), left > 0 ? left : 0, snz > 0 ? snz : 0);
        for (int i = 0; i < BIRD_COUNT; i++) J("%s\"%s\"", i ? "," : "", bird_name(i));
        J("]},");
    }
    J("\"panel\":{\"key_col\":%d,\"menu_col\":%d,\"night_col\":%d,\"knob_light\":%d,\"auto_night\":%d,\"clock12\":%d,\"snooze\":%d,\"palette\":[",
      S.key_col, S.menu_col, S.night_col, S.knob_light, S.auto_night, S.clock12, S.snooze_min);
    for (int i = 0; i < N_PAL; i++) J("%s\"%s\"", i ? "," : "", PAL[i].name);
    {   int vx, vy, vw, vh; viewport(&vx, &vy, &vw, &vh);
        J("],\"auto_update\":%d,\"turn_hints\":%d,\"quick_menus\":%d,\"settle_full\":%d,\"wf_temp\":%d,\"temp_sensed\":%d,\"temp_forced\":%d,\"refresh_mode\":%d,\"night_keys\":%d,\"overlay\":%d,\"show\":%d,\"at_night\":%d,\"tz\":%d,\"auto_time\":%d,\"vp\":[%d,%d,%d,%d],\"tzs\":[",
          S.auto_update, S.turn_hints, S.quick_menus, S.settle_full, S.wf_temp, it8951_temp_sensed(), it8951_temp_forced(), S.refresh_mode, S.night_keys, S.overlay, S.show, S.at_night, S.tz, S.auto_time, vx, vy, vw, vh); }
    for (int i = 0; i < N_TZ; i++) J("%s\"%s\"", i ? "," : "", TZ_NAMES[i]);
    J("],\"keyacts\":[");
    for (int i = 0; i < N_KEYACT; i++) J("%s{\"id\":\"%s\",\"label\":\"%s\"}", i ? "," : "", KEYACT_ID[i], KEYACT_NAME[i]);
    J("],\"knobacts\":[");
    for (int i = 0; i < N_KNOBACT; i++) J("%s{\"id\":\"%s\",\"label\":\"%s\"}", i ? "," : "", KNOBACT_ID[i], KNOBACT_NAME[i]);
    J("]},");
    J("\"shape\":{\"patter\":%d,\"wash\":%d,\"tone\":%d,\"wind\":%d,\"surface\":%d,\"thunder\":%d,\"thunder_near\":%d},",
      S.patter, S.wash, S.tone, S.wind, S.surface, S.thunder, S.thunder_near);
    J("\"hw\":{\"speaker\":%d,\"spk_on\":%d,\"i2s_fills\":%lu,\"i2s_diag\":%lu,\"power_mon\":%d,\"on_battery\":%d,\"pct\":%d,\"bat_mv\":%d,\"usb_mv\":%d,"
      "\"rec\":\"%s\"},",
      S.speaker, audio_speaker_playing(), (unsigned long)audio_speaker_fills(), (unsigned long)audio_i2s_diag(), S.power_mon, S.on_battery, S.batt_pct, (int)(power_battery_v() * 1000), (int)(power_usb_v() * 1000),
      S.rec);
    J("\"lights\":{\"on\":%d,\"bright\":%d,\"colour\":%d},", S.lights_on, S.bright, S.light_mode);
    J("\"ac\":{\"mode\":%d,\"sp\":%d.%d,\"fan\":%d,\"room\":%d.%d},", S.ac_mode, S.sp_x2 / 2, (S.sp_x2 % 2) * 5, S.fan, S.room_x10 / 10, S.room_x10 % 10);
    J("\"picks\":[");
    for (int i = 0; i < tesserae_pick_count(); i++) J("%s\"%s\"", i ? "," : "", tesserae_pick_title(i));
    J("],\"pick\":%d,", S.dash_page ? s_dash_sel - 1 : -1);
    J("\"night\":%d,\"keylights\":%d,\"dash\":%d,\"dashes\":[\"%s\",\"%s\",\"%s\"],\"phase\":%d,\"screen\":\"%s\",\"alarms\":[",
      S.night, inputs_backlight() * 100 / 255, S.dash_page, DASHES[0], DASHES[1], DASHES[2], (int)S.phase, local_screen_name(local_screen()));
    for (int i = 0; i < s_nalarms; i++) {
        int mask = 0; for (int d = 0; d < 7; d++) if (s_alarms[i].days[d]) mask |= 1 << d;
        char dt[40]; alarm_days_txt(&s_alarms[i], dt, sizeof dt);
        J("%s{\"h\":%d,\"m\":%d,\"on\":%d,\"days\":%d,\"early\":%d,\"dt\":\"%s\"}", i ? "," : "", s_alarms[i].h, s_alarms[i].m, s_alarms[i].on, mask, s_alarms[i].early, dt);
    }
    J("],\"max_alarms\":%d}", MAX_ALARMS);
#undef J
    return n < cap ? n : cap - 1;
}

